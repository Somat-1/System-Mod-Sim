/*
 * Step-timing identification - ESP32-S3 + TMC2209, RMT-generated step train.
 *
 * NOT YET COMPILED OR RUN. No toolchain was available where this was written.
 * Bring it up with the motor uncoupled and read PROCEDURE below.
 *
 * This runs the same transfer as the open-loop diagnostic, at 2, 5 and
 * 8 mm/s with 40 mm/s^2, so its numbers drop straight onto the existing
 * measurement. What changes is how the pulses are produced. The previous
 * firmware lost 18% of every interval to a telemetry write that blocked
 * inside the pulse loop, and added a further 14.35 us to every interval
 * because the scheduler took its deadline from micros() AFTER emitting the
 * pulse. Measured: T_actual = 1.2176 * T_nominal + 14.35 us, which is why
 * 8 mm/s commanded delivered 5.707 mm/s. Three changes remove both terms.
 *
 *   1. The step train is generated by the RMT peripheral, not by the CPU.
 *      Symbol durations are written into a buffer and the hardware clocks
 *      them out. Nothing the CPU does afterwards can stretch an interval.
 *
 *   2. The profile is precomputed into those durations. There is no
 *      per-pulse deadline to drift, because there is no per-pulse software
 *      timing at all - the ramp is a sequence of durations, not a sequence
 *      of waits.
 *
 *   3. Nothing is printed while the stage is moving. Every record goes into
 *      a RAM buffer and the whole lot is emitted after the sequence ends.
 *
 * The cost of (1) is that a burst cannot be stopped between pulses, only
 * between chunks. A chunk is CHUNK_SYMBOLS pulses, so the stop granularity
 * is 128 * 0.625 um = 80 um at speed and 16 * 0.625 um = 10 um while homing.
 * The soft limits keep 2 mm clear of the switches, so this is covered; do not
 * reduce that margin without shrinking the chunk.
 *
 * PROCEDURE
 *   1. Compile with ESP32 Arduino core 3.x (ESP-IDF 5.x) - driver/rmt_tx.h.
 *   2. Flash, open scripts/iso_terminal.py, keep the log.
 *   3. Start the interferometer recording before motion.
 *   4. Press 'h' to home, then 'r' for the timing sequence, or 'g' for
 *      home -> warm-up -> continuous shuttle. 'd' dumps the buffer.
 *   5. The timing sequence takes ~9.5 min; records appear after
 *      # SEQ_DONE. Warm-up and shuttle run until a key is pressed and
 *      report a summary instead of per-traverse records.
 *
 * WIRING matches the ISO firmware: STEP 7, DIR 8, EN 9 (active low),
 * TMC UART TX 17 / RX 18, end switches NEG 10 / POS 11 (NO to ground,
 * internal pull-up, so pressed reads LOW - not fail-safe).
 */

#include <Arduino.h>
#include <TMCStepper.h>
#include "driver/rmt_tx.h"

// ---- pins -----------------------------------------------------------------
constexpr uint8_t STEP_PIN = 7;
constexpr uint8_t DIR_PIN = 8;
constexpr uint8_t EN_PIN = 9;
constexpr uint8_t UART_RX_PIN = 18;
constexpr uint8_t UART_TX_PIN = 17;
constexpr uint8_t SW_NEG_PIN = 10;
constexpr uint8_t SW_POS_PIN = 11;
constexpr int SWITCH_ACTIVE_LEVEL = LOW;

// ---- driver ---------------------------------------------------------------
constexpr uint8_t DRIVER_ADDRESS = 0;
constexpr float R_SENSE_OHM = 0.10F;
constexpr uint32_t DRIVER_BAUD = 115200;
constexpr uint16_t RUN_CURRENT_MA = 400;
constexpr uint16_t MRES = 16;

// ---- geometry -------------------------------------------------------------
constexpr double LEAD_MM = 2.0;
constexpr double STEPS_PER_REV = 200.0;
constexpr double FS_PER_MM = STEPS_PER_REV / LEAD_MM;      // 100
constexpr double PULSES_PER_MM = FS_PER_MM * MRES;         // 1600
constexpr double UM_PER_PULSE = 1000.0 / PULSES_PER_MM;    // 0.625

// ---- RMT ------------------------------------------------------------------
// 1 MHz ticks: 1 us resolution, and the 15-bit duration field reaches 32.7 ms,
// which covers everything from the 0.15 mm/s homing crawl upward.
constexpr uint32_t RMT_HZ = 1000000;
constexpr uint16_t STEP_HIGH_US = 3;
constexpr size_t CHUNK_SYMBOLS = 128;      // pulses per queued transaction
constexpr size_t HOME_CHUNK = 16;          // finer stop granularity when homing
constexpr size_t RING = 6;                 // buffers; must exceed queue depth
constexpr size_t QUEUE_DEPTH = 4;
constexpr uint32_t MAX_PERIOD_US = 30000;

// ---- motion ---------------------------------------------------------------
constexpr double ACCEL_MM_S2 = 40.0;
constexpr double HOME_SEEK_MM_S = 2.0;
constexpr double HOME_SLOW_MM_S = 0.15;
constexpr double HOME_BACKOFF_MM = 2.0;
constexpr uint8_t HOME_TOUCHES = 3;
constexpr double HOME_TOL_MM = 0.02;
constexpr double END_MARGIN_MM = 2.0;
constexpr double HOME_MAX_TRAVEL_MM = 200.0;

// ---- the sequence ---------------------------------------------------------
struct Profile { const char *name; double v_mm_s; double a_mm_s2; };
constexpr Profile PROFILES[] = {
  {"v2", 2.0, ACCEL_MM_S2},
  {"v5", 5.0, ACCEL_MM_S2},
  {"v8", 8.0, ACCEL_MM_S2},
};
constexpr uint8_t PROFILE_COUNT = sizeof(PROFILES) / sizeof(PROFILES[0]);
constexpr uint8_t CYCLES = 2;
constexpr uint32_t HOLD_MS = 10000;
constexpr double LOW_MM = 2.0;
constexpr double PRE_MM = 58.35;
constexpr double XREF_MM = 61.35;
constexpr double WARMUP_MM_S = 5.0;     // conditioning speed
constexpr double SHUTTLE_MM_S = 8.0;    // the endurance speed

// ---- buffered records -----------------------------------------------------
// Nothing is printed during motion. Each record is 32 bytes; 256 of them
// covers this sequence several times over.
struct Record {
  char kind;              // 'M' move, 'H' hold, 'X' marker
  const char *profile;
  const char *leg;
  int8_t cycle;
  uint32_t t0_ms, t1_ms;
  uint32_t pulses;
  double x_from_mm, x_to_mm, v_mm_s, a_mm_s2;
};
constexpr size_t MAX_RECORDS = 256;
Record records[MAX_RECORDS];
size_t recordCount = 0;
uint32_t recordsDropped = 0;

rmt_channel_handle_t rmtChannel = nullptr;
rmt_encoder_handle_t rmtEncoder = nullptr;
rmt_symbol_word_t ringBuf[RING][CHUNK_SYMBOLS];
size_t ringIndex = 0;

HardwareSerial TmcSerial(1);
TMC2209Stepper driver(&TmcSerial, R_SENSE_OHM, DRIVER_ADDRESS);

int64_t posPulses = 0;          // signed, from the homed datum
bool homed = false, driverReady = false, abortRequested = false;
bool stopRequested = false;   // any key, during a continuous run
bool continuousMode = false;  // only then may a key halt a move
bool recording = true;        // off while shuttling, or the
                              // record buffer fills in minutes
bool lastDirPositive = true, dirKnown = false;
int64_t limNegPulses = 0, limPosPulses = 0;

// ------------------------------------------------------------------ helpers

inline double mmOf(int64_t pulses) { return (double)pulses / PULSES_PER_MM; }
inline int64_t pulsesOf(double mm) { return (int64_t)llround(mm * PULSES_PER_MM); }

void note(char kind, const char *profile, int8_t cycle, const char *leg,
          uint32_t t0, uint32_t t1, uint32_t pulses,
          double from_mm, double to_mm, double v, double a) {
  if (!recording) return;
  if (recordCount >= MAX_RECORDS) { ++recordsDropped; return; }
  Record &r = records[recordCount++];
  r.kind = kind; r.profile = profile; r.leg = leg; r.cycle = cycle;
  r.t0_ms = t0; r.t1_ms = t1; r.pulses = pulses;
  r.x_from_mm = from_mm; r.x_to_mm = to_mm; r.v_mm_s = v; r.a_mm_s2 = a;
}

/* Any key stops a continuous run; Ctrl+C aborts outright. Polled
 * between chunks, which costs nothing because the RMT queue is
 * already running ahead of the CPU. */
bool pollStop() {
  while (Serial.available()) {
    const char c = (char)Serial.read();
    if (c == 3) abortRequested = true;
    if (c != '\n' && c != '\r') stopRequested = true;
  }
  // A stray key must not truncate a move in the timing sequence; it only
  // halts motion while a continuous run is in progress.
  return abortRequested || (continuousMode && stopRequested);
}

bool switchPressed(uint8_t pin) {
  if (digitalRead(pin) != SWITCH_ACTIVE_LEVEL) return false;
  delayMicroseconds(300);
  return digitalRead(pin) == SWITCH_ACTIVE_LEVEL;
}
bool switchNeg() { return switchPressed(SW_NEG_PIN); }
bool switchPos() { return switchPressed(SW_POS_PIN); }
bool switchAhead(bool positive) { return positive ? switchPos() : switchNeg(); }

// -------------------------------------------------------------------- RMT

bool rmtBegin() {
  rmt_tx_channel_config_t cfg = {};
  cfg.gpio_num = (gpio_num_t)STEP_PIN;
  cfg.clk_src = RMT_CLK_SRC_DEFAULT;
  cfg.resolution_hz = RMT_HZ;
  cfg.mem_block_symbols = 64;
  cfg.trans_queue_depth = QUEUE_DEPTH;
  cfg.flags.invert_out = false;
  cfg.flags.with_dma = false;
  if (rmt_new_tx_channel(&cfg, &rmtChannel) != ESP_OK) return false;
  rmt_copy_encoder_config_t enc = {};
  if (rmt_new_copy_encoder(&enc, &rmtEncoder) != ESP_OK) return false;
  return rmt_enable(rmtChannel) == ESP_OK;
}

/* One pulse as an RMT symbol: STEP high for STEP_HIGH_US, then low for the
 * remainder of the period. The hardware clocks this out; the CPU is only
 * ever filling the next buffer. */
inline void makeSymbol(rmt_symbol_word_t &s, uint32_t period_us) {
  if (period_us <= STEP_HIGH_US) period_us = STEP_HIGH_US + 1;
  if (period_us > MAX_PERIOD_US) period_us = MAX_PERIOD_US;
  s.level0 = 1; s.duration0 = STEP_HIGH_US;
  s.level1 = 0; s.duration1 = period_us - STEP_HIGH_US;
}

void setDirection(bool positive) {
  if (dirKnown && positive == lastDirPositive) return;
  digitalWrite(DIR_PIN, positive ? HIGH : LOW);
  delayMicroseconds(20);
  lastDirPositive = positive;
  dirKnown = true;
}

/* Emit `pulses` steps with a trapezoidal rate profile.
 *
 * The periods are computed into the buffer in advance, so the ramp is a list
 * of durations rather than a list of waits. Chunks are queued back to back;
 * rmt_transmit blocks once the queue is full, which is what keeps the
 * hardware fed without the CPU having to time anything. A buffer is only
 * reused after RING-1 further transmits, by which point its transaction has
 * certainly completed, because the queue holds at most QUEUE_DEPTH.
 *
 * Returns the number of pulses actually emitted.
 */
uint32_t emitPulses(uint32_t pulses, bool positive, double v_mm_s,
                    double a_mm_s2, size_t chunk, bool seeking) {
  if (pulses == 0) return 0;
  setDirection(positive);

  const double vMax = v_mm_s * PULSES_PER_MM;          // pulses/s
  const double accel = a_mm_s2 * PULSES_PER_MM;        // pulses/s^2
  uint32_t nAcc = (uint32_t)(vMax * vMax / (2.0 * accel));
  if (2 * nAcc > pulses) nAcc = pulses / 2;

  uint32_t done = 0;
  while (done < pulses) {
    if (pollStop()) break;
    // Stop granularity is one chunk; the soft limits leave 2 mm of room.
    // Only the switch in the direction of travel stops a move. Checking both
    // refused every move off a pressed switch - homing ends on one, so its
    // back-offs and the first warm-up move never ran.
    if (switchAhead(positive)) break;
    if (!seeking && homed) {
      // Block only motion that goes further outside the soft limits: after
      // homing the stage sits on the positive switch, 2 mm past the limit.
      const int64_t next = posPulses + (positive ? (int64_t)chunk
                                                 : -(int64_t)chunk);
      if ((positive && next > limPosPulses) || (!positive && next < limNegPulses)) break;
    }
    const uint32_t n = (uint32_t)min((size_t)(pulses - done), chunk);
    rmt_symbol_word_t *buf = ringBuf[ringIndex];
    ringIndex = (ringIndex + 1) % RING;
    for (uint32_t k = 0; k < n; ++k) {
      const uint32_t i = done + k;
      double v;
      if (i < nAcc)                 v = sqrt(2.0 * accel * (double)(i + 1));
      else if (i >= pulses - nAcc)  v = sqrt(2.0 * accel * (double)(pulses - i));
      else                          v = vMax;
      if (v < 1.0) v = 1.0;
      makeSymbol(buf[k], (uint32_t)llround(1000000.0 / v));
    }
    rmt_transmit_config_t tx = {};
    tx.loop_count = 0;
    if (rmt_transmit(rmtChannel, rmtEncoder, buf,
                     n * sizeof(rmt_symbol_word_t), &tx) != ESP_OK) break;
    done += n;
    posPulses += positive ? (int64_t)n : -(int64_t)n;
  }
  rmt_tx_wait_all_done(rmtChannel, -1);
  return done;
}

/* A move to an absolute position, recorded but not printed. */
uint32_t moveTo(int64_t target, double v_mm_s, double a_mm_s2,
                const char *profile, int8_t cycle, const char *leg,
                size_t chunk = CHUNK_SYMBOLS, bool seeking = false) {
  const int64_t delta = target - posPulses;
  if (delta == 0) return 0;
  const bool positive = delta > 0;
  const uint32_t want = (uint32_t)(positive ? delta : -delta);
  const double from_mm = mmOf(posPulses);
  const uint32_t t0 = millis();
  const uint32_t got = emitPulses(want, positive, v_mm_s, a_mm_s2,
                                  chunk, seeking);
  const uint32_t t1 = millis();
  note('M', profile, cycle, leg, t0, t1, got, from_mm, mmOf(posPulses),
       v_mm_s, a_mm_s2);
  return got;
}

void hold(uint32_t ms, const char *profile, int8_t cycle, const char *point) {
  const uint32_t t0 = millis();
  const double x = mmOf(posPulses);
  const uint32_t until = t0 + ms;
  while ((int32_t)(millis() - until) < 0) {
    if (Serial.available() && Serial.read() == 3) abortRequested = true;
    if (abortRequested) break;
    delay(2);
  }
  note('H', profile, cycle, point, t0, millis(), 0, x, x, 0.0, 0.0);
}

// ----------------------------------------------------------------- driver

bool configureDriver() {
  digitalWrite(EN_PIN, HIGH);
  TmcSerial.begin(DRIVER_BAUD, SERIAL_8N1, UART_RX_PIN, UART_TX_PIN);
  delay(100);
  driver.begin();
  driver.toff(5);
  driver.blank_time(24);
  driver.pdn_disable(true);
  driver.mstep_reg_select(true);
  driver.I_scale_analog(false);
  driver.rms_current(RUN_CURRENT_MA);
  driver.ihold(driver.irun());
  driver.iholddelay(0);
  driver.TPOWERDOWN(0);
  driver.en_spreadCycle(true);
  driver.TPWMTHRS(0);
  driver.intpol(false);
  driver.pwm_autoscale(false);
  uint8_t code = 8;
  for (uint16_t v = MRES; v > 1; v >>= 1) --code;
  const uint32_t MASK = 0x0F000000UL;
  driver.CHOPCONF((driver.CHOPCONF() & ~MASK) | ((uint32_t)code << 24));
  uint8_t connection = 2;
  for (uint8_t i = 0; i < 5 && connection; ++i) {
    connection = driver.test_connection();
    if (connection) delay(50);
  }
  if (connection) return false;
  if (((driver.CHOPCONF() & MASK) >> 24) != code) return false;
  digitalWrite(EN_PIN, LOW);
  return true;
}

// ----------------------------------------------------------------- homing

bool homeEnd(bool positive, int64_t *trigger) {
  const char *name = positive ? "pos" : "neg";
  if (switchAhead(positive))
    moveTo(posPulses + (positive ? -pulsesOf(HOME_BACKOFF_MM)
                                 : pulsesOf(HOME_BACKOFF_MM)),
           HOME_SLOW_MM_S, ACCEL_MM_S2, "home", -1, name, HOME_CHUNK);
  moveTo(posPulses + (positive ? pulsesOf(HOME_MAX_TRAVEL_MM)
                               : -pulsesOf(HOME_MAX_TRAVEL_MM)),
         HOME_SEEK_MM_S, ACCEL_MM_S2, "home", -1, "seek", HOME_CHUNK, true);
  if (abortRequested || !switchAhead(positive)) return false;
  int64_t touch[HOME_TOUCHES];
  for (uint8_t t = 0; t < HOME_TOUCHES; ++t) {
    moveTo(posPulses + (positive ? -pulsesOf(HOME_BACKOFF_MM)
                                 : pulsesOf(HOME_BACKOFF_MM)),
           HOME_SLOW_MM_S, ACCEL_MM_S2, "home", -1, "backoff", HOME_CHUNK);
    moveTo(posPulses + (positive ? pulsesOf(3 * HOME_BACKOFF_MM)
                                 : -pulsesOf(3 * HOME_BACKOFF_MM)),
           HOME_SLOW_MM_S, ACCEL_MM_S2, "home", -1, "touch", HOME_CHUNK, true);
    if (abortRequested || !switchAhead(positive)) return false;
    touch[t] = posPulses;
  }
  int64_t lo = touch[0], hi = touch[0];
  for (uint8_t t = 1; t < HOME_TOUCHES; ++t) {
    if (touch[t] < lo) lo = touch[t];
    if (touch[t] > hi) hi = touch[t];
  }
  if (mmOf(hi - lo) > HOME_TOL_MM) return false;
  *trigger = positive ? lo : hi;
  return true;
}

bool homeBoth() {
  homed = false; abortRequested = false;
  Serial.println("# HOMING,start");
  int64_t negT = 0, posT = 0;
  if (!homeEnd(false, &negT)) { Serial.println("# ERR,home_neg"); return false; }
  moveTo(posPulses + pulsesOf(HOME_BACKOFF_MM), HOME_SLOW_MM_S, ACCEL_MM_S2,
         "home", -1, "clear", HOME_CHUNK);
  if (!homeEnd(true, &posT)) { Serial.println("# ERR,home_pos"); return false; }
  const int64_t travel = posT - negT;
  posPulses -= negT;                       // datum at the negative switch
  limNegPulses = pulsesOf(END_MARGIN_MM);
  limPosPulses = travel - pulsesOf(END_MARGIN_MM);
  homed = true;
  Serial.printf("# HOMED,travel_mm=%.4f,lim_mm=%.3f..%.3f\n",
                mmOf(travel), mmOf(limNegPulses), mmOf(limPosPulses));
  return true;
}

// --------------------------------------------------------------- sequence

void dumpRecords() {
  Serial.printf("# DUMP_BEGIN,records=%u,dropped=%lu\n",
                (unsigned)recordCount, (unsigned long)recordsDropped);
  for (size_t i = 0; i < recordCount; ++i) {
    const Record &r = records[i];
    if (r.kind == 'M') {
      Serial.printf("# MOVE,%s,%d,%s,t0=%lu,t1=%lu,elapsed_ms=%lu,"
                    "pulses=%lu,x_from_mm=%.6f,x_to_mm=%.6f,"
                    "v_mm_s=%.3f,a_mm_s2=%.3f\n",
                    r.profile, r.cycle, r.leg, (unsigned long)r.t0_ms,
                    (unsigned long)r.t1_ms,
                    (unsigned long)(r.t1_ms - r.t0_ms),
                    (unsigned long)r.pulses, r.x_from_mm, r.x_to_mm,
                    r.v_mm_s, r.a_mm_s2);
    } else if (r.kind == 'H') {
      Serial.printf("# HOLD,%s,%d,%s,t0=%lu,t1=%lu,elapsed_ms=%lu,"
                    "x_mm=%.6f\n",
                    r.profile, r.cycle, r.leg, (unsigned long)r.t0_ms,
                    (unsigned long)r.t1_ms,
                    (unsigned long)(r.t1_ms - r.t0_ms), r.x_from_mm);
    } else {
      Serial.printf("# MARK,%s,%d,%s,t_ms=%lu,x_mm=%.6f\n",
                    r.profile, r.cycle, r.leg, (unsigned long)r.t0_ms,
                    r.x_from_mm);
    }
  }
  Serial.println("# DUMP_END");
}

void runSequence() {
  if (!homed) { Serial.println("# ERR,not_homed"); return; }
  recordCount = 0; recordsDropped = 0; abortRequested = false;
  const uint32_t started = millis();
  Serial.printf("# SEQ_BEGIN,t_ms=%lu,profiles=%u,cycles=%u,hold_ms=%lu,"
                "low_mm=%.3f,pre_mm=%.3f,xref_mm=%.3f,"
                "rmt_hz=%lu,chunk=%u,buffered=1\n",
                (unsigned long)started, PROFILE_COUNT, CYCLES,
                (unsigned long)HOLD_MS, LOW_MM, PRE_MM, XREF_MM,
                (unsigned long)RMT_HZ, (unsigned)CHUNK_SYMBOLS);
  Serial.println("# SEQ_NOTE,no output during motion; records follow SEQ_DONE");

  for (uint8_t p = 0; p < PROFILE_COUNT && !abortRequested; ++p) {
    const Profile &pr = PROFILES[p];
    note('X', pr.name, -1, "profile_start", millis(), millis(), 0,
         mmOf(posPulses), mmOf(posPulses), pr.v_mm_s, pr.a_mm_s2);
    for (uint8_t c = 1; c <= CYCLES && !abortRequested; ++c) {
      moveTo(pulsesOf(LOW_MM), pr.v_mm_s, pr.a_mm_s2, pr.name, c, "to_low");
      moveTo(pulsesOf(PRE_MM), pr.v_mm_s, pr.a_mm_s2, pr.name, c, "low_to_pre");
      moveTo(pulsesOf(XREF_MM), pr.v_mm_s, pr.a_mm_s2, pr.name, c, "pre_to_xref");
      hold(HOLD_MS, pr.name, c, "xref");
      moveTo(pulsesOf(LOW_MM), pr.v_mm_s, pr.a_mm_s2, pr.name, c, "xref_to_low");
      hold(HOLD_MS, pr.name, c, "low");
    }
    note('X', pr.name, -1, "profile_end", millis(), millis(), 0,
         mmOf(posPulses), mmOf(posPulses), pr.v_mm_s, pr.a_mm_s2);
  }

  // Park on the gentlest profile, whatever order the list is in.
  uint8_t slow = 0;
  for (uint8_t p = 1; p < PROFILE_COUNT; ++p)
    if (PROFILES[p].v_mm_s < PROFILES[slow].v_mm_s) slow = p;
  moveTo(pulsesOf(XREF_MM), PROFILES[slow].v_mm_s, PROFILES[slow].a_mm_s2,
         "park", -1, "park_to_xref");

  Serial.printf("# SEQ_DONE,t_ms=%lu,elapsed_ms=%lu,x_mm=%.6f,aborted=%u\n",
                (unsigned long)millis(),
                (unsigned long)(millis() - started), mmOf(posPulses),
                abortRequested ? 1u : 0u);
  dumpRecords();
}

/* Run end to end between the soft limits until a key is pressed.
 *
 * Per-traverse records are suppressed - a soak fills 256 of them in a couple
 * of minutes - so the result is a summary instead: the achieved speed is
 * 2 x span / mean cycle time, which is the number that says whether the RMT
 * generator really sustains the commanded rate.
 */
void shuttle(double v_mm_s, const char *label) {
  if (!homed) { Serial.println("# ERR,not_homed"); return; }
  stopRequested = false; abortRequested = false; continuousMode = true;
  const double span = mmOf(limPosPulses - limNegPulses);
  Serial.printf("# SHUTTLE_BEGIN,%s,v_mm_s=%.2f,span_mm=%.3f\n",
                label, v_mm_s, span);
  Serial.println("# press any key to stop (Ctrl+C aborts)");

  moveTo(limNegPulses, v_mm_s, ACCEL_MM_S2, label, -1, "to_start");
  recording = false;
  const uint32_t started = millis();
  uint32_t cycles = 0, fastest = 0xFFFFFFFFUL, slowest = 0;
  uint64_t total = 0;
  while (!stopRequested && !abortRequested) {
    const uint32_t t0 = millis();
    moveTo(limPosPulses, v_mm_s, ACCEL_MM_S2, label, -1, "fwd");
    if (stopRequested || abortRequested) break;
    moveTo(limNegPulses, v_mm_s, ACCEL_MM_S2, label, -1, "rev");
    if (stopRequested || abortRequested) break;
    const uint32_t dt = millis() - t0;
    ++cycles; total += dt;
    if (dt < fastest) fastest = dt;
    if (dt > slowest) slowest = dt;
  }
  recording = true; continuousMode = false;
  const uint32_t elapsed = millis() - started;
  const double mean_s = cycles ? (double)total / cycles / 1000.0 : 0.0;
  Serial.printf("# SHUTTLE_DONE,%s,cycles=%lu,elapsed_s=%.1f,"
                "mean_cycle_s=%.3f,fastest_s=%.3f,slowest_s=%.3f,"
                "achieved_mm_s=%.3f,commanded_mm_s=%.2f,x_mm=%.6f,"
                "aborted=%u\n",
                label, (unsigned long)cycles, elapsed / 1000.0, mean_s,
                cycles ? fastest / 1000.0 : 0.0,
                cycles ? slowest / 1000.0 : 0.0,
                mean_s > 0.0 ? 2.0 * span / mean_s : 0.0,
                v_mm_s, mmOf(posPulses), abortRequested ? 1u : 0u);
}

// ------------------------------------------------------------------- shell

void menu() {
  Serial.println(F("\n--- step-timing identification ---"));
  Serial.printf(" driver=%u homed=%u  1/%u  %u mA  RMT %lu Hz\n",
                driverReady ? 1u : 0u, homed ? 1u : 0u, MRES,
                RUN_CURRENT_MA, (unsigned long)RMT_HZ);
  Serial.println(F("  h  home          r  timing sequence   d  dump records"));
  Serial.printf (  "  w  warm-up %.0f mm/s  c  shuttle %.0f mm/s    "
                   "g  home+warm+shuttle\n",
                WARMUP_MM_S, SHUTTLE_MM_S);
  Serial.println(F("  s  switches      0  release motor     Ctrl+C abort"));
  Serial.print(F("> "));
}

void setup() {
  pinMode(EN_PIN, OUTPUT); digitalWrite(EN_PIN, HIGH);
  pinMode(STEP_PIN, OUTPUT); digitalWrite(STEP_PIN, LOW);
  pinMode(DIR_PIN, OUTPUT); digitalWrite(DIR_PIN, HIGH);
  pinMode(SW_NEG_PIN, INPUT_PULLUP);
  pinMode(SW_POS_PIN, INPUT_PULLUP);
  Serial.begin(115200);
  const uint32_t start = millis();
  while (!Serial && millis() - start < 3000) delay(10);
  delay(200);

  Serial.println("# BOOT,fw=step_timing_test");
  Serial.printf("# PINS,step=%u,dir=%u,en=%u,uart_rx=%u,uart_tx=%u,"
                "sw_neg=%u,sw_pos=%u\n",
                STEP_PIN, DIR_PIN, EN_PIN, UART_RX_PIN, UART_TX_PIN,
                SW_NEG_PIN, SW_POS_PIN);
  if (!rmtBegin()) Serial.println("# ERR,rmt_init_failed");
  driverReady = configureDriver();
  if (!driverReady) Serial.println("# ERR,driver_config_failed");
  Serial.printf("# READY,driver=%u,rmt=%u,um_per_pulse=%.4f\n",
                driverReady ? 1u : 0u, rmtChannel ? 1u : 0u, UM_PER_PULSE);
  menu();
}

void loop() {
  if (!Serial.available()) { delay(5); return; }
  const char key = (char)Serial.read();
  if (key == '\n' || key == '\r') return;
  Serial.println(key);
  switch (key) {
    case 'h': homeBoth(); break;
    case 'r': runSequence(); break;
    case 'w': shuttle(WARMUP_MM_S, "warmup"); break;
    case 'c': shuttle(SHUTTLE_MM_S, "shuttle"); break;
    case 'g':
      if (homeBoth()) {
        shuttle(WARMUP_MM_S, "warmup");
        if (!abortRequested) shuttle(SHUTTLE_MM_S, "shuttle");
      }
      break;
    case 'a':
      // Home, centre, hold 10 s (start the recording), then the 2/5/8 mm/s
      // timing sequence. Ctrl+C aborts at any point.
      if (homeBoth()) {
        const int64_t centre = (limNegPulses + limPosPulses) / 2;
        moveTo(centre, HOME_SEEK_MM_S, ACCEL_MM_S2, "auto", -1, "to_centre");
        Serial.printf("# AUTO_CENTRE,x_mm=%.4f,wait_s=10\n", mmOf(posPulses));
        hold(10000, "auto", -1, "centre_wait");
        if (!abortRequested) runSequence();
      }
      break;
    case 'd': dumpRecords(); break;
    case 's':
      Serial.printf("# SWITCHES,neg=%u,pos=%u\n",
                    switchNeg() ? 1u : 0u, switchPos() ? 1u : 0u);
      break;
    case '0':
      digitalWrite(EN_PIN, HIGH); homed = false;
      Serial.println("Outputs off. Travel invalidated - home again.");
      break;
    case 3: abortRequested = true; Serial.println("# ABORT"); break;
    default: Serial.println("Unknown key."); break;
  }
  menu();
}
