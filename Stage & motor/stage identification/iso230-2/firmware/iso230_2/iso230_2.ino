/*
 * ISO 230-2 baseline runner - ESP32-S3 + TMC2209 + two end switches.
 *
 * COMPILED, NOT YET RUN ON HARDWARE.
 *
 * The state machine of ../../PROCEDURE.md, picked from a menu on the USB CDC
 * terminal (use ../../scripts/iso_terminal.py - keys act at once):
 *
 *   1  Home + warm-up    INIT -> HOME -> WARMUP. Homing finds the home switch
 *                        (commanded zero) and, if configured, the far switch to
 *                        measure the travel. The targets are then placed and
 *                        distributed automatically over what was measured. The
 *                        warm-up repeats the ISO run unrecorded; a key latches
 *                        the stop, which takes effect at the end of the cycle.
 *   2  ISO sequence      DATUM -> ISO_CYCLE (n runs) -> END_REF -> PARK.
 *
 * Everything is configured in ../../config/iso_config.json, compiled in through
 * iso_config.h (generated by scripts/iso_design.py). Reflash after a change.
 *
 * COORDINATES. x is in u256 = 1/256 full step, measured from the home switch's
 * slow trigger and increasing away from it, whichever physical side that is.
 * The motor's own position (motorU256, positive = DIR high) is mapped to x by
 * xOf()/motorOf(). Every fixed-side approach comes from below (smaller x).
 *
 * The interferometer is not read here - it streams on its own. This sketch
 * emits every event with the board's millisecond clock, the commanded position,
 * and the record window of every stop, so the IDS record can be cut into stops
 * offline. Lines:
 *
 *   # S,<t_ms>,<x_u256>,<enc>,<mscnt>,<state>        50 Hz while moving/dwelling
 *   # EVENT,<t_ms>,<state>,<event>,<run>,<dir>,<i>,<x_u256>
 *   # STOP,<state>,<run>,<dir>,<i>,<x_u256>,<x_mm>,<t_arrive>,<t_rec0>,<t_rec1>,<enc_mean>
 *   # TARGET,<i>,<x_u256>,<x_mm>
 *
 * WIRING - the Stepper Isolated bench (see ../../../../CONNECTIONS.md):
 *   STEP GPIO7   DIR GPIO8   EN GPIO9 (ENN, active low)
 *   TMC UART TX GPIO17 (via 1k) / RX GPIO18
 *   ENCODER  A GPIO4   B GPIO5   Z GPIO6
 *   END SWITCH neg GPIO10   pos GPIO11   (NO to GND, internal pull-up)
 */

#include <Arduino.h>
#include <TMCStepper.h>
#include <math.h>
#include "driver/pulse_cnt.h"
#include "iso_config.h"

// ---- pins -----------------------------------------------------------------
constexpr uint8_t STEP_PIN = 7;
constexpr uint8_t DIR_PIN = 8;
constexpr uint8_t EN_PIN = 9;            // TMC ENN: HIGH = outputs off
constexpr uint8_t UART_RX_PIN = 18;
constexpr uint8_t UART_TX_PIN = 17;
constexpr uint8_t LED_PIN = 48;
constexpr gpio_num_t ENC_A = GPIO_NUM_4;
constexpr gpio_num_t ENC_B = GPIO_NUM_5;
constexpr gpio_num_t ENC_Z = GPIO_NUM_6;
constexpr uint8_t SW_NEG_PIN = 10;       // switch at the DIR-low end
constexpr uint8_t SW_POS_PIN = 11;       // switch at the DIR-high end
constexpr int SWITCH_ACTIVE_LEVEL = LOW; // NO to GND + internal pull-up

// ---- driver ---------------------------------------------------------------
constexpr uint8_t DRIVER_ADDRESS = 0;
constexpr float R_SENSE_OHM = 0.10F;
constexpr uint32_t DRIVER_BAUD = 115200;

// ---- geometry and rates ---------------------------------------------------
constexpr int64_t U256 = 256;
constexpr double FS_PER_MM = (double)CFG_STEPS_PER_REV / CFG_LEAD_MM;
constexpr double UPMM = FS_PER_MM * (double)U256;            // u256 per mm
constexpr uint32_t MAX_PULSE_RATE_HZ = 20000;
constexpr float MIN_PULSE_RATE_HZ = 2.0F;
constexpr uint32_t STEP_HIGH_US = 3;
constexpr uint32_t DIR_SETUP_US = 20;
constexpr uint32_t SAMPLE_INTERVAL_MS = 20;    // 50 Hz telemetry
constexpr uint32_t SWITCH_DEBOUNCE_US = 3000;
constexpr size_t MAX_TARGETS = 64;             // must match scripts/iso_design.py
// The seek has no practical travel cap; it ends on its switch or ABORT. 1 m
// only gives the move a finite target.
constexpr double HOME_MAX_TRAVEL_MM = 1000.0;

HardwareSerial TmcSerial(1);
TMC2209Stepper driver(&TmcSerial, R_SENSE_OHM, DRIVER_ADDRESS);
pcnt_unit_handle_t pcnt = nullptr;

// ---- state ----------------------------------------------------------------
enum State : uint8_t {
  ST_IDLE, ST_INIT, ST_HOME, ST_WARMUP, ST_WARMUP_REF, ST_DATUM, ST_ISO,
  ST_ISO_REF, ST_END_REF, ST_PARK, ST_ABORT
};
const char *STATE_NAME[] = {"IDLE", "INIT", "HOME", "WARMUP", "WARMUP_REF",
                            "DATUM", "ISO", "ISO_REF", "END_REF", "PARK", "ABORT"};

enum StopReason : uint8_t {
  STOP_NONE = 0, STOP_ABORT, STOP_SWITCH, STOP_LIMIT, STOP_KEY, STOP_ERROR,
  STOP_DRIVER
};
const char *STOP_NAME[] = {"none", "abort", "switch", "soft_limit", "key",
                           "error", "driver_fault"};

/** What the warm-up ended with. */
enum WarmupOutcome : uint8_t { WARMUP_FAILED, WARMUP_TO_MENU, WARMUP_TO_ISO };

/** How the switches are treated for one move. */
enum GuardMode : uint8_t {
  GUARD_NORMAL,    // either switch is a fault
  GUARD_SEEK,      // the switch ahead is the goal; the one behind is a fault
  GUARD_RETRACT    // moving off a pressed switch: ignore both
};

struct Settings {
  uint16_t currentMa = CFG_RUN_CURRENT_MA;
  uint16_t vFs = 0;                 // set in setup() from CFG_V_MM_S
  uint8_t nRuns = CFG_N_RUNS;
  uint16_t warmupMaxMin = CFG_WARMUP_T_MAX_MIN;
} cfg;

const int8_t HOME_SIGN = CFG_HOME_MIN ? 1 : -1;   // x = HOME_SIGN * (motor - home)
const uint16_t MRES = CFG_MRES;
const int64_t STEP_U256 = U256 / CFG_MRES;
uint32_t accelPulsesS2 = 0;

int64_t motorU256 = 0;              // commanded motor position
int64_t homeMotorU256 = 0;          // motor position of the home slow trigger
bool driverReady = false, encoderReady = false;
bool homed = false, running = false, abortRequested = false;
State state = ST_IDLE;
StopReason stopReason = STOP_NONE;
bool lastDirPositive = true, dirKnown = false;
uint32_t nextSampleMs = 0;
volatile int32_t indexCount = 0;

// Travel and the plan, in x.
int64_t romU256 = 0, softMinU256 = 0, softMaxU256 = 0, xRefU256 = 0;
int64_t targetU256[MAX_TARGETS];
uint8_t nTargets = 0;
double intervalMm = 0.0;

// Seek fault arming: the switch behind only counts once it has been seen open.
bool behindArmed = false;

// Input.
String inBuf;
String pendingLine;
char pendingKey = 0;
bool hotkeys = false;     // a lone character is a key, not a line
bool keyStops = false;    // a key stops the motion under way
constexpr char ABORT_BYTE = 0x03;   // Ctrl+C from iso_terminal.py, always ABORT

// Live key handling while a long state runs (handled at every dwell).
enum KeyMode : uint8_t { KEYS_NONE, KEYS_WARMUP, KEYS_PROGRESS };
KeyMode keyMode = KEYS_NONE;
bool warmupLatched = false, warmupGoIso = false;
int progressRun = -1, progressStop = 0;

// ---------------------------------------------------------------- helpers

int64_t xOf(int64_t motor) { return HOME_SIGN * (motor - homeMotorU256); }
int64_t motorOf(int64_t x) { return homeMotorU256 + HOME_SIGN * x; }
int64_t xNow() { return xOf(motorU256); }
double mmOf(int64_t u) { return (double)u / UPMM; }
uint16_t fsOf(double mmPerS) { return (uint16_t)lround(mmPerS * FS_PER_MM); }

/** mm -> u256 on the microstep grid. Mirrors snap_u256() in iso_design.py. */
int64_t snapU256(double mm) {
  const int64_t u = (int64_t)floor(mm * UPMM + 0.5);
  return ((u + STEP_U256 / 2) / STEP_U256) * STEP_U256;
}

/** mm -> u256 on a full step. */
int64_t snapFullStep(double mm) {
  return (int64_t)floor(mm * UPMM / (double)U256 + 0.5) * U256;
}

void event(const char *what, int run = -1, int dir = 0, int i = -1) {
  Serial.printf("# EVENT,%lu,%s,%s,%d,%d,%d,%lld\n", (unsigned long)millis(),
                STATE_NAME[state], what, run, dir, i, (long long)xNow());
}

void setState(State s) {
  state = s;
  event("state_change");
}

// ---------------------------------------------------------------- encoder

void IRAM_ATTR onIndex() { indexCount = indexCount + 1; }

int32_t encoderCount() {
  int value = 0;
  if (pcnt) pcnt_unit_get_count(pcnt, &value);
  return value;
}

bool setupEncoder() {
  pcnt_unit_config_t uc = {};
  uc.high_limit = 30000;
  uc.low_limit = -30000;
  uc.flags.accum_count = 1;
  if (pcnt_new_unit(&uc, &pcnt) != ESP_OK) return false;
  pcnt_glitch_filter_config_t filt = {};
  filt.max_glitch_ns = 1000;
  pcnt_unit_set_glitch_filter(pcnt, &filt);
  pcnt_chan_config_t a = {}, b = {};
  a.edge_gpio_num = ENC_A; a.level_gpio_num = ENC_B;
  b.edge_gpio_num = ENC_B; b.level_gpio_num = ENC_A;
  pcnt_channel_handle_t cha = nullptr, chb = nullptr;
  if (pcnt_new_channel(pcnt, &a, &cha) != ESP_OK) return false;
  if (pcnt_new_channel(pcnt, &b, &chb) != ESP_OK) return false;
  pcnt_channel_set_edge_action(cha, PCNT_CHANNEL_EDGE_ACTION_DECREASE,
                               PCNT_CHANNEL_EDGE_ACTION_INCREASE);
  pcnt_channel_set_level_action(cha, PCNT_CHANNEL_LEVEL_ACTION_KEEP,
                                PCNT_CHANNEL_LEVEL_ACTION_INVERSE);
  pcnt_channel_set_edge_action(chb, PCNT_CHANNEL_EDGE_ACTION_INCREASE,
                               PCNT_CHANNEL_EDGE_ACTION_DECREASE);
  pcnt_channel_set_level_action(chb, PCNT_CHANNEL_LEVEL_ACTION_KEEP,
                                PCNT_CHANNEL_LEVEL_ACTION_INVERSE);
  gpio_pullup_en(ENC_A);
  gpio_pullup_en(ENC_B);
  pcnt_unit_add_watch_point(pcnt, 30000);
  pcnt_unit_add_watch_point(pcnt, -30000);
  pcnt_unit_enable(pcnt);
  pcnt_unit_clear_count(pcnt);
  pcnt_unit_start(pcnt);
  pinMode(ENC_Z, INPUT_PULLUP);
  attachInterrupt(digitalPinToInterrupt(ENC_Z), onIndex, RISING);
  return true;
}

// ----------------------------------------------------------- end switches

/** Debounced: the pin must hold the active level for the whole window. */
bool switchPressed(uint8_t pin) {
  if (digitalRead(pin) != SWITCH_ACTIVE_LEVEL) return false;
  const uint32_t until = micros() + SWITCH_DEBOUNCE_US;
  while ((int32_t)(micros() - until) < 0) {
    if (digitalRead(pin) != SWITCH_ACTIVE_LEVEL) return false;
  }
  return true;
}

bool switchNeg() { return switchPressed(SW_NEG_PIN); }
bool switchPos() { return switchPressed(SW_POS_PIN); }
/** The switch in the direction of motor motion. */
bool switchAhead(bool positive) { return positive ? switchPos() : switchNeg(); }
/** Home is at x = 0, so moving towards smaller x approaches it. */
bool towardsHomeIsPositiveMotor() { return HOME_SIGN < 0; }

// ------------------------------------------------------------------ input

void pumpSerial() {
  while (Serial.available()) {
    const char ch = (char)Serial.read();
    if (ch == ABORT_BYTE) { abortRequested = true; inBuf = ""; continue; }
    if (ch == '\r' || ch == '\n') {
      String line = inBuf;
      inBuf = "";
      line.trim();
      if (line.length()) {
        if (line.equalsIgnoreCase("ABORT")) abortRequested = true;
        else pendingLine = line;
      }
      continue;
    }
    if (ch == 8 || ch == 127) {
      if (inBuf.length()) inBuf.remove(inBuf.length() - 1);
      continue;
    }
    if (inBuf.length() < 180) inBuf += ch;
    if (hotkeys && inBuf.length() == 1) {
      pendingKey = inBuf[0];
      inBuf = "";
    } else if (!hotkeys && inBuf.length() == 1 && (isdigit(ch) || ch == '?')) {
      pendingLine = inBuf;       // menu keys act at once
      inBuf = "";
    }
  }
}

void setKeys(bool hot, bool stops) {
  hotkeys = hot;
  keyStops = stops;
  pendingKey = 0;
  inBuf = "";
}

char takeKey() {
  pumpSerial();
  const char k = pendingKey;
  pendingKey = 0;
  return k;
}

void drainInput() {
  delay(20);
  while (Serial.available()) Serial.read();
}

/** Wait for one key, without Enter. Enter comes back as '\n'. */
char readKey(const char *prompt) {
  const bool saved = hotkeys;
  hotkeys = false;
  drainInput();
  Serial.print(prompt);
  for (;;) {
    if (Serial.available()) {
      char ch = (char)Serial.read();
      if (ch == '\r') ch = '\n';
      Serial.println(ch == '\n' ? ' ' : ch);
      hotkeys = saved;
      return ch;
    }
    delay(2);
  }
}

/** Blocking line prompt with echo. ESC cancels. */
String readLine(const char *prompt) {
  const bool saved = hotkeys;
  hotkeys = false;
  drainInput();
  Serial.print(prompt);
  String s;
  for (;;) {
    if (!Serial.available()) { delay(2); continue; }
    const char ch = (char)Serial.read();
    if (ch == '\r') continue;
    if (ch == '\n') { Serial.println(); break; }
    if (ch == 27) { s = ""; Serial.println(" (cancelled)"); break; }
    if (ch == 8 || ch == 127) {
      if (s.length()) { s.remove(s.length() - 1); Serial.print("\b \b"); }
      continue;
    }
    if (s.length() < 40) { s += ch; Serial.print(ch); }
  }
  hotkeys = saved;
  s.trim();
  return s;
}

// ----------------------------------------------------------------- driver

uint32_t readMscnt() { return driver.MSCNT(); }

void applyCurrent(uint16_t ma) {
  driver.rms_current(ma);
  long ihold = lroundf(driver.irun() * CFG_IHOLD_MULT);
  ihold = constrain(ihold, 0L, 31L);
  driver.ihold((uint8_t)ihold);
  cfg.currentMa = ma;
}

bool applyMres(uint16_t value) {
  uint8_t code = 8;
  for (uint16_t v = value; v > 1; v >>= 1) --code;
  const uint32_t MASK = 0x0F000000UL;
  for (uint8_t attempt = 0; attempt < 5; ++attempt) {
    const uint32_t chop = driver.CHOPCONF();
    driver.CHOPCONF((chop & ~MASK) | ((uint32_t)code << 24));
    if (((driver.CHOPCONF() & MASK) >> 24) == code) return true;
    delay(5);
  }
  Serial.println("# ERR,reason=mres_write_failed");
  return false;
}

void reportDriver() {
  const uint32_t g = driver.GCONF();
  const uint32_t c = driver.CHOPCONF();
  const uint32_t d = driver.DRV_STATUS();
  Serial.printf("# DRIVER,gconf=0x%08lX,chopconf=0x%08lX,drv_status=0x%08lX,"
                "spreadcycle=%u,intpol=%u,stealth=%u,mres=%u,irun=%u,ihold=%u,"
                "tpowerdown=%u,iholddelay=%u,current_ma=%u\n",
                (unsigned long)g, (unsigned long)c, (unsigned long)d,
                (g & (1UL << 2)) ? 1u : 0u, (c & (1UL << 28)) ? 1u : 0u,
                (d & (1UL << 30)) ? 1u : 0u, MRES, driver.irun(), driver.ihold(),
                CFG_TPOWERDOWN, CFG_IHOLDDELAY, cfg.currentMa);
}

/**
 * Driver watchdog. Over-temperature and short-to-ground/supply stop the run;
 * the pre-warning and open-load flags are only reported - open load can read
 * set at standstill without a fault.
 */
bool driverHealthy() {
  const uint32_t d = driver.DRV_STATUS();
  const bool fault = d & ((1UL << 1) | (1UL << 2) | (1UL << 3) |
                          (1UL << 4) | (1UL << 5));      // ot, s2ga/b, s2vsa/b
  if (d & ((1UL << 0) | (1UL << 6) | (1UL << 7)))        // otpw, ola, olb
    Serial.printf("# WARN,driver_status=0x%08lX\n", (unsigned long)d);
  if (fault) {
    Serial.printf("# ERR,reason=driver_fault,drv_status=0x%08lX\n", (unsigned long)d);
    stopReason = STOP_DRIVER;
  }
  return !fault;
}

/** INIT: write every register, read it back, refuse to enable on a mismatch. */
bool configureDriver() {
  digitalWrite(EN_PIN, HIGH);
  TmcSerial.begin(DRIVER_BAUD, SERIAL_8N1, UART_RX_PIN, UART_TX_PIN);
  delay(100);
  const uint32_t ioin = driver.IOIN();
  Serial.printf("# DRIVER_ID,ioin=0x%08lX,version=0x%02X,expected=0x21\n",
                (unsigned long)ioin, (unsigned)((ioin >> 24) & 0xFF));
  driver.begin();
  driver.toff(5);
  driver.blank_time(24);
  driver.pdn_disable(true);
  driver.mstep_reg_select(true);
  driver.I_scale_analog(false);
  applyCurrent(cfg.currentMa);
  driver.iholddelay(CFG_IHOLDDELAY);
  driver.TPOWERDOWN(CFG_TPOWERDOWN);
  driver.en_spreadCycle(true);
  driver.TPWMTHRS(0);
  driver.intpol(CFG_INTPOL);
  driver.semin(0);
  driver.TCOOLTHRS(0);
  driver.pwm_autoscale(false);

  uint8_t connection = 2;
  for (uint8_t i = 0; i < 5 && connection; ++i) {
    connection = driver.test_connection();
    if (connection) delay(50);
  }
  if (connection) { Serial.println("# ERR,reason=driver_no_reply"); return false; }
  if (!applyMres(MRES)) return false;

  const uint32_t g = driver.GCONF();
  const uint32_t c = driver.CHOPCONF();
  const uint32_t d = driver.DRV_STATUS();
  const bool spread = g & (1UL << 2);
  const bool intpol = c & (1UL << 28);
  const bool stealth = d & (1UL << 30);
  const uint8_t mresCode = (c >> 24) & 0x0F;
  uint8_t want = 8;
  for (uint16_t v = MRES; v > 1; v >>= 1) --want;
  if (!spread || stealth || intpol != CFG_INTPOL || mresCode != want) {
    Serial.printf("# ERR,reason=driver_readback_mismatch,spreadcycle=%u,"
                  "stealth=%u,intpol=%u,mres_code=%u\n",
                  spread, stealth, intpol, mresCode);
    return false;
  }
  reportDriver();
  return true;
}

// ------------------------------------------------------------- telemetry

void emitSample() {
  Serial.printf("# S,%lu,%lld,%ld,%lu,%s\n", (unsigned long)millis(),
                (long long)xNow(), (long)encoderCount(),
                (unsigned long)readMscnt(), STATE_NAME[state]);
}

void serviceTelemetry() {
  const uint32_t now = millis();
  if ((int32_t)(now - nextSampleMs) >= 0) {
    emitSample();
    nextSampleMs = now + SAMPLE_INTERVAL_MS;
  }
}

// ----------------------------------------------------------------- motion

/** Checked before every pulse. */
bool motionGuard(bool positive, GuardMode mode) {
  if (abortRequested) { stopReason = STOP_ABORT; return false; }
  if (keyStops && pendingKey) { stopReason = STOP_KEY; return false; }
  if (mode == GUARD_NORMAL) {
    if (switchNeg() || switchPos()) { stopReason = STOP_SWITCH; return false; }
    if (homed) {
      // Block only motion that goes further outside, so a stage resting a
      // microstep past a limit (rounding at the back-off) can still come in.
      const int64_t x = xOf(motorU256 + (positive ? STEP_U256 : -STEP_U256));
      const bool xUp = (positive ? 1 : -1) * HOME_SIGN > 0;
      if ((x < softMinU256 && !xUp) || (x > softMaxU256 && xUp)) {
        stopReason = STOP_LIMIT;
        return false;
      }
    }
  } else if (mode == GUARD_SEEK) {
    if (switchAhead(positive)) { stopReason = STOP_SWITCH; return false; }
    // The opposite switch closing during a seek means the stage is going the
    // wrong way (swapped pins or DIR sense). Ignore it until it has been seen
    // open, so a seek may start from a pressed switch.
    const bool behind = positive ? switchNeg() : switchPos();
    if (!behind) behindArmed = true;
    else if (behindArmed) {
      Serial.println("# ERR,reason=opposite_switch_during_seek");
      stopReason = STOP_ERROR;
      return false;
    }
  }
  return true;
}

void pulseOnce(bool positive) {
  if (!dirKnown || positive != lastDirPositive) {
    digitalWrite(DIR_PIN, positive ? HIGH : LOW);
    delayMicroseconds(DIR_SETUP_US);
    lastDirPositive = positive;
    dirKnown = true;
  }
  digitalWrite(STEP_PIN, HIGH);
  delayMicroseconds(STEP_HIGH_US);
  digitalWrite(STEP_PIN, LOW);
  motorU256 += positive ? STEP_U256 : -STEP_U256;
}

/** Keys during the warm-up and the ISO sequence: latch the stop, or report. */
void serviceKeys() {
  if (keyMode == KEYS_NONE || keyStops || !pendingKey) return;
  const char k = pendingKey;
  pendingKey = 0;
  if (keyMode == KEYS_WARMUP) {
    if (!warmupLatched) {
      warmupLatched = true;
      event("stop_request");
      Serial.println("\n  stop latched - the warm-up ends after this cycle. "
                     "Press i to go straight into the ISO sequence.");
    } else if (k == 'i' && !warmupGoIso) {
      warmupGoIso = true;
      Serial.println("\n  -> ISO sequence after this cycle");
    }
  } else {
    Serial.printf("\n  run %d/%u, %d stops recorded, x %.4f mm\n", progressRun + 1,
                  cfg.nRuns, progressStop, mmOf(xNow()));
  }
}

bool dwellMs(uint32_t ms) {
  const uint32_t until = millis() + ms;
  while ((int32_t)(millis() - until) < 0) {
    serviceTelemetry();
    pumpSerial();
    serviceKeys();
    if (abortRequested) { stopReason = STOP_ABORT; return false; }
    if (keyStops && pendingKey) { stopReason = STOP_KEY; return false; }
    delay(1);
  }
  return true;
}

/** Trapezoidal move of the motor to an absolute u256 target. */
bool moveMotorTo(int64_t target, uint16_t speedFs, GuardMode mode) {
  const int64_t delta = target - motorU256;
  if (delta == 0) return true;
  const bool positive = delta > 0;
  const int64_t magnitude = positive ? delta : -delta;
  if (magnitude % STEP_U256 != 0) {
    Serial.printf("# ERR,reason=target_off_grid,target=%lld\n", (long long)target);
    stopReason = STOP_ERROR;
    return false;
  }
  if (speedFs == 0 || (uint32_t)speedFs * MRES > MAX_PULSE_RATE_HZ) {
    Serial.printf("# ERR,reason=pulse_rate,speed_fs=%u\n", speedFs);
    stopReason = STOP_ERROR;
    return false;
  }
  if (mode == GUARD_SEEK) behindArmed = false;
  const uint32_t pulses = (uint32_t)(magnitude / STEP_U256);
  const float vMax = (float)speedFs * (float)MRES;
  const float accel = (float)accelPulsesS2;
  uint32_t nAcc = (uint32_t)(vMax * vMax / (2.0F * accel));
  if (2 * nAcc > pulses) nAcc = pulses / 2;

  for (uint32_t i = 0; i < pulses; ++i) {
    if (!motionGuard(positive, mode)) return false;
    pulseOnce(positive);
    float v;
    if (i < nAcc)                v = sqrtf(2.0F * accel * (float)(i + 1));
    else if (i >= pulses - nAcc) v = sqrtf(2.0F * accel * (float)(pulses - i));
    else                         v = vMax;
    if (v < MIN_PULSE_RATE_HZ) v = MIN_PULSE_RATE_HZ;
    if (v > (float)MAX_PULSE_RATE_HZ) v = (float)MAX_PULSE_RATE_HZ;
    const uint32_t due = micros() + (uint32_t)(1000000.0F / v);
    while ((int32_t)(micros() - due) < 0) {
      serviceTelemetry();
      pumpSerial();
      if (abortRequested) { stopReason = STOP_ABORT; return false; }
      if (keyStops && pendingKey) { stopReason = STOP_KEY; return false; }
    }
  }
  return true;
}

/** Move to x at the approach velocity, inside the soft limits. */
bool moveX(int64_t x) {
  if (homed && (x < softMinU256 || x > softMaxU256)) {
    Serial.printf("# ERR,reason=outside_soft_limits,x=%lld\n", (long long)x);
    stopReason = STOP_LIMIT;
    return false;
  }
  return moveMotorTo(motorOf(x), cfg.vFs, GUARD_NORMAL);
}

// --------------------------------------------------------- dwell + record

/**
 * Arrive, settle t_settle (t_hold + margin), then record t_record. The record
 * window is reported with board times so the interferometer stream can be cut
 * offline; the encoder is averaged over the same window.
 */
bool dwellRecord(int run, int dir, int i) {
  const uint32_t tArrive = millis();
  event("arrive", run, dir, i);
  if (!dwellMs(CFG_T_SETTLE_MS)) return false;
  const uint32_t t0 = millis();
  event("record_start", run, dir, i);
  int64_t encSum = 0;
  uint32_t n = 0;
  const uint32_t until = t0 + CFG_T_RECORD_MS;
  while ((int32_t)(millis() - until) < 0) {
    encSum += encoderCount();
    ++n;
    serviceTelemetry();
    pumpSerial();
    if (abortRequested) { stopReason = STOP_ABORT; return false; }
    if (keyStops && pendingKey) { stopReason = STOP_KEY; return false; }
    delay(1);
  }
  const uint32_t t1 = millis();
  event("record_end", run, dir, i);
  const int64_t x = xNow();
  Serial.printf("# STOP,%s,%d,%d,%d,%lld,%.6f,%lu,%lu,%lu,%.2f\n",
                STATE_NAME[state], run, dir, i, (long long)x, mmOf(x),
                (unsigned long)tArrive, (unsigned long)t0, (unsigned long)t1,
                n ? (double)encSum / (double)n : 0.0);
  ++progressStop;
  return true;
}

/** Fixed-side x_ref visit: pre-move below, approach, dwell and record. */
bool visitXref(State as, int run) {
  const State saved = state;
  state = as;
  event("xref", run);
  const int64_t pre = snapU256(mmOf(xRefU256) - CFG_REF_PREAPPROACH_MM);
  bool ok = moveX(pre) && moveX(xRefU256) && driverHealthy() &&
            dwellRecord(run, 0, -1);
  state = saved;
  return ok;
}

/** One ISO 230-2 standard linear run (PROCEDURE.md 5.1). */
bool isoRun(State runState, State refState, int run) {
  if (!visitXref(refState, run)) return false;
  state = runState;
  const int64_t ov = snapU256(CFG_OVERRUN_MM);
  event("overrun", run, -1, 0);
  if (!moveX(targetU256[0] - ov)) return false;
  for (uint8_t i = 0; i < nTargets; ++i) {
    event("move_start", run, +1, i + 1);
    if (!moveX(targetU256[i]) || !dwellRecord(run, +1, i + 1)) return false;
  }
  event("overrun", run, +1, nTargets);
  if (!moveX(targetU256[nTargets - 1] + ov)) return false;
  for (int i = nTargets - 1; i >= 0; --i) {
    event("move_start", run, -1, i + 1);
    if (!moveX(targetU256[i]) || !dwellRecord(run, -1, i + 1)) return false;
  }
  event("overrun", run, -1, 1);
  return moveX(targetU256[0] - ov);
}

// ------------------------------------------------------------ the targets

/** Identical to XorShift32 in iso_design.py. */
uint32_t rngState = 1;
double rngUniform() {
  uint32_t x = rngState;
  x ^= x << 13;
  x ^= x >> 17;
  x ^= x << 5;
  rngState = x;
  return (double)(x >> 8) / 16777216.0;
}

/**
 * Place and distribute the targets over the measured travel (PROCEDURE.md 4),
 * then check every planned position against the soft limits (INIT step 6).
 * Mirrors place_targets() in iso_design.py operation for operation.
 */
bool placeTargets() {
  const double rom = mmOf(romU256);
  const double softMin = CFG_END_MARGIN_MM;
  const double softMax = rom - CFG_END_MARGIN_MM;
  const double xStart = softMin + CFG_OVERRUN_MM;
  const double xEndRaw = softMax - CFG_OVERRUN_MM;
  const double xEnd = floor(xEndRaw / CFG_TARGET_END_QUANTUM_MM) * CFG_TARGET_END_QUANTUM_MM;
  if (xEnd - xStart < CFG_P_NOM_MM) {
    Serial.println("# ERR,reason=travel_too_short_for_targets");
    return false;
  }
  const int m = (int)floor((xEnd - xStart) / CFG_P_NOM_MM + 0.5) + 1;
  if (m > (int)MAX_TARGETS) {
    Serial.printf("# ERR,reason=too_many_targets,m=%d\n", m);
    return false;
  }
  const double p = (xEnd - xStart) / (double)(m - 1);
  rngState = CFG_SEED ? CFG_SEED : 1;
  for (int k = 0; k < m; ++k) {
    const double u = rngUniform();
    double t = xStart + (double)k * p + (u * 2.0 - 1.0) * p / 4.0;
    if (k == 0) t = xStart;
    if (k == m - 1) t = xEnd;
    t = floor(t * 1000.0 + 0.5) / 1000.0;
    targetU256[k] = snapU256(t);
  }
  nTargets = (uint8_t)m;
  intervalMm = p;
  softMinU256 = snapU256(softMin);
  softMaxU256 = (int64_t)floor(softMax * UPMM);          // never past the limit
  softMaxU256 -= softMaxU256 % STEP_U256;
  xRefU256 = snapFullStep(CFG_X_REF_MM < 0 ? (softMin + softMax) / 2.0 : CFG_X_REF_MM);

  const int64_t ov = snapU256(CFG_OVERRUN_MM);
  const int64_t pre = snapU256(mmOf(xRefU256) - CFG_REF_PREAPPROACH_MM);
  const int64_t checks[] = {targetU256[0] - ov, targetU256[m - 1] + ov, pre, xRefU256};
  for (int64_t x : checks) {
    if (x < softMinU256 || x > softMaxU256) {
      Serial.printf("# ERR,reason=plan_outside_soft_limits,x=%lld\n", (long long)x);
      return false;
    }
  }
  for (int k = 1; k < m; ++k) {
    if (targetU256[k] <= targetU256[k - 1]) {
      Serial.println("# ERR,reason=targets_not_increasing");
      return false;
    }
  }
  return true;
}

void printPlan() {
  if (!homed) { Serial.println("Not homed - the targets are placed after homing."); return; }
  const double dwell = (CFG_T_SETTLE_MS + CFG_T_RECORD_MS) / 1000.0;
  Serial.printf("# PLAN,rom_mm=%.4f,targets=%u,interval_mm=%.4f,x_start=%.4f,"
                "x_end=%.4f,x_ref=%.4f,soft_min=%.4f,soft_max=%.4f,seed=%lu,"
                "dwell_s=%.2f,runs=%u,config=%s\n",
                mmOf(romU256), nTargets, intervalMm, mmOf(targetU256[0]),
                mmOf(targetU256[nTargets - 1]), mmOf(xRefU256), mmOf(softMinU256),
                mmOf(softMaxU256), (unsigned long)CFG_SEED, dwell, cfg.nRuns, CFG_HASH);
  for (uint8_t i = 0; i < nTargets; ++i)
    Serial.printf("# TARGET,%u,%lld,%.6f\n", i + 1, (long long)targetU256[i],
                  mmOf(targetU256[i]));
}

// ----------------------------------------------------------------- homing

/** Back off a pressed switch by `mm`, ignoring the switches while doing so. */
bool backOff(bool awayPositive, double mm) {
  const int64_t d = snapU256(mm);
  return moveMotorTo(motorU256 + (awayPositive ? d : -d), fsOf(CFG_HOME_SLOW_MM_S),
                     GUARD_RETRACT);
}

/**
 * Fast seek to a switch, back off, slow re-approach. Returns the motor
 * position of the slow trigger, and reports both triggers.
 */
bool findSwitch(bool positive, const char *name, int64_t *slowTrigger) {
  if (switchAhead(positive) && !backOff(!positive, CFG_HOME_BACKOFF_MM)) return false;
  int64_t far = (int64_t)(HOME_MAX_TRAVEL_MM * UPMM);
  far -= far % STEP_U256;
  stopReason = STOP_NONE;
  event(positive ? "seek_pos" : "seek_neg");
  moveMotorTo(motorU256 + (positive ? far : -far), fsOf(CFG_HOME_SEEK_MM_S), GUARD_SEEK);
  if (stopReason != STOP_SWITCH || !switchAhead(positive)) {
    if (stopReason == STOP_NONE) Serial.printf("# ERR,reason=no_switch,end=%s\n", name);
    return false;
  }
  const int64_t fast = motorU256;
  if (!backOff(!positive, CFG_HOME_BACKOFF_MM)) return false;
  if (switchAhead(positive)) {
    Serial.printf("# ERR,reason=switch_still_closed,end=%s\n", name);
    stopReason = STOP_ERROR;
    return false;
  }
  stopReason = STOP_NONE;
  const int64_t creep = snapU256(CFG_HOME_BACKOFF_MM * 3.0);
  moveMotorTo(motorU256 + (positive ? creep : -creep), fsOf(CFG_HOME_SLOW_MM_S), GUARD_SEEK);
  if (stopReason != STOP_SWITCH || !switchAhead(positive)) {
    if (stopReason == STOP_NONE)
      Serial.printf("# ERR,reason=slow_approach_missed_switch,end=%s\n", name);
    return false;
  }
  *slowTrigger = motorU256;
  Serial.printf("# SWITCH,%s,fast_motor=%lld,slow_motor=%lld,fast_minus_slow_um=%.3f\n",
                name, (long long)fast, (long long)motorU256,
                (double)(fast - motorU256) * 1000.0 / UPMM);
  return true;
}

/** HOME (PROCEDURE.md 3.2), plus the far switch to measure the travel. */
bool home() {
  homed = false;
  setState(ST_HOME);
  digitalWrite(EN_PIN, LOW);
  const bool homePositive = towardsHomeIsPositiveMotor();
  int64_t homeTrig = 0, farTrig = 0;
  if (!findSwitch(homePositive, "home", &homeTrig)) return false;
  homeMotorU256 = homeTrig;                         // commanded zero
  if (!backOff(!homePositive, CFG_HOME_BACKOFF_MM)) return false;

  if (CFG_MEASURE_FAR_END) {
    if (!findSwitch(!homePositive, "far", &farTrig)) return false;
    romU256 = xOf(farTrig);
    if (!backOff(homePositive, CFG_HOME_BACKOFF_MM)) return false;
  } else {
    romU256 = snapU256(CFG_ROM_EXPECTED_MM);
  }
  if (!placeTargets()) { stopReason = STOP_ERROR; return false; }
  homed = true;
  Serial.printf("# HOMED,rom_u256=%lld,rom_mm=%.4f,rom_expected_mm=%.1f,"
                "home_motor=%lld\n", (long long)romU256, mmOf(romU256),
                CFG_ROM_EXPECTED_MM, (long long)homeMotorU256);
  printPlan();

  // Park at x_ref via the fixed-side approach.
  const int64_t pre = snapU256(mmOf(xRefU256) - CFG_REF_PREAPPROACH_MM);
  return moveX(pre) && moveX(xRefU256);
}

// ---------------------------------------------------------------- warm-up

/**
 * WARMUP (PROCEDURE.md 3.3). Repeats the ISO run unrecorded until the operator
 * stops it or t_max. A key LATCHES the stop at once, but the cycle in progress
 * finishes first, so DATUM always starts from the same friction and thermal
 * state. t_max goes straight on to the ISO sequence, as specified.
 */
WarmupOutcome runWarmup() {
  setState(ST_WARMUP);
  Serial.printf("\nWarm-up: the ISO run, unrecorded, %u targets, x_ref every %u "
                "cycle(s), at most %u min.\n"
                "  any key: stop at the end of this cycle   Ctrl+C: ABORT now\n",
                nTargets, CFG_WARMUP_REF_EVERY, cfg.warmupMaxMin);
  setKeys(true, false);                 // keys are read, they do not stop motion
  warmupLatched = warmupGoIso = false;
  keyMode = KEYS_WARMUP;
  const uint32_t started = millis();
  uint32_t cycle = 0;
  bool tMax = false;

  for (;;) {
    const bool ref = (cycle % CFG_WARMUP_REF_EVERY) == 0;
    // isoRun() visits x_ref at its start; on the cycles that have one it is the
    // warm-up x_ref visit, so the move pattern is exactly the ISO run.
    if (!isoRun(ST_WARMUP, ref ? ST_WARMUP_REF : ST_WARMUP, (int)cycle)) {
      keyMode = KEYS_NONE;
      setKeys(false, false);
      return WARMUP_FAILED;
    }
    ++cycle;
    const uint32_t min = (millis() - started) / 60000UL;
    Serial.printf("  warm-up cycle %lu done, %lu min\n", (unsigned long)cycle,
                  (unsigned long)min);
    if (warmupLatched) break;
    if (min >= cfg.warmupMaxMin) { tMax = true; break; }
  }
  keyMode = KEYS_NONE;
  setKeys(false, false);
  event("warmup_end");
  Serial.printf("# WARMUP_END,reason=%s,cycles=%lu,minutes=%.1f\n",
                tMax ? "t_max" : "operator", (unsigned long)cycle,
                (millis() - started) / 60000.0);
  state = ST_IDLE;
  if (tMax || warmupGoIso) return WARMUP_TO_ISO;
  return readKey("  warm-up done.  i = ISO sequence now   m = menu > ") == 'i'
             ? WARMUP_TO_ISO : WARMUP_TO_MENU;
}

// ------------------------------------------------------------ ISO sequence

void abortAndMaybePark() {
  const StopReason why = stopReason;
  const State where = state;
  state = ST_ABORT;
  keyMode = KEYS_NONE;
  digitalWrite(LED_PIN, LOW);
  setKeys(false, false);
  Serial.printf("# ABORTED,state=%s,reason=%s,x=%lld\n", STATE_NAME[where],
                STOP_NAME[why], (long long)xNow());
  // A limit switch, soft limit or driver fault means the position is not to be
  // trusted: stay put and disable. Otherwise offer to park.
  if (why == STOP_SWITCH || why == STOP_LIMIT || why == STOP_DRIVER || why == STOP_ERROR) {
    digitalWrite(EN_PIN, HIGH);
    homed = false;
    Serial.println("Motor disabled - home again before moving.");
    return;
  }
  abortRequested = false;
  if (readKey("Aborted.  p = park at x_ref   any other key = stay here > ") == 'p') {
    setState(ST_PARK);
    const int64_t pre = snapU256(mmOf(xRefU256) - CFG_REF_PREAPPROACH_MM);
    if (moveX(pre) && moveX(xRefU256)) Serial.println("Parked.");
  }
  state = ST_IDLE;
}

/** DATUM -> ISO_CYCLE -> END_REF -> PARK. */
void runIso() {
  if (!homed) { Serial.println("Not homed - run 1 first."); return; }
  if (!driverHealthy()) { abortAndMaybePark(); return; }
  const uint32_t started = millis();
  abortRequested = false;
  stopReason = STOP_NONE;
  // Keys do not stop the measurement (Ctrl+C sends ABORT); they show progress.
  setKeys(true, false);
  digitalWrite(LED_PIN, HIGH);
  keyMode = KEYS_PROGRESS;
  progressRun = -1;
  progressStop = 0;
  Serial.printf("\nISO 230-2 sequence: %u runs x %u targets x 2 directions.  "
                "Ctrl+C = ABORT, any key = progress.\n", cfg.nRuns, nTargets);
  printPlan();

  setState(ST_DATUM);
  for (uint8_t k = 0; k < CFG_DATUM_VISITS; ++k) {
    if (!visitXref(ST_DATUM, k)) { abortAndMaybePark(); return; }
  }
  setState(ST_ISO);
  for (uint8_t run = 0; run < cfg.nRuns; ++run) {
    progressRun = run;
    Serial.printf("  run %u/%u  (%.1f min)\n", run + 1, cfg.nRuns,
                  (millis() - started) / 60000.0);
    if (!isoRun(ST_ISO, ST_ISO_REF, run)) { abortAndMaybePark(); return; }
  }
  setState(ST_END_REF);
  for (uint8_t k = 0; k < CFG_END_REF_VISITS; ++k) {
    if (!visitXref(ST_END_REF, k)) { abortAndMaybePark(); return; }
  }
  setState(ST_PARK);
  const int64_t pre = snapU256(mmOf(xRefU256) - CFG_REF_PREAPPROACH_MM);
  if (!moveX(pre) || !moveX(xRefU256)) { abortAndMaybePark(); return; }
  if (!CFG_END_HOLD) {
    digitalWrite(EN_PIN, HIGH);
    homed = false;
  }
  digitalWrite(LED_PIN, LOW);
  keyMode = KEYS_NONE;
  setKeys(false, false);
  Serial.printf("# ISO_DONE,runs=%u,stops=%u,minutes=%.1f,end_motor=%s\n",
                cfg.nRuns, (unsigned)(cfg.nRuns * 2 * nTargets),
                (millis() - started) / 60000.0, CFG_END_HOLD ? "hold" : "disabled");
  setState(ST_IDLE);
}

// -------------------------------------------------------------------- menu

void printConfig() {
  Serial.printf("  lead %.3f mm  %u steps/rev  1/%u  (%.4f um per microstep)\n"
                "  run current %u mA  ihold x%.2f  tpowerdown %u  iholddelay %u  "
                "intpol %u\n"
                "  v %.2f mm/s (%u FS/s)  a %.1f mm/s^2  home seek %.2f / slow %.2f mm/s\n"
                "  margin %.1f  overrun %.1f  p_nom %.1f mm  seed %lu  x_ref %s\n"
                "  settle %lu ms + record %lu ms   runs %u   warm-up max %u min   "
                "end %s   config %s\n",
                CFG_LEAD_MM, CFG_STEPS_PER_REV, MRES, 1000.0 / (FS_PER_MM * MRES),
                cfg.currentMa, CFG_IHOLD_MULT, CFG_TPOWERDOWN, CFG_IHOLDDELAY,
                CFG_INTPOL ? 1u : 0u, cfg.vFs / FS_PER_MM, cfg.vFs, CFG_A_MM_S2,
                CFG_HOME_SEEK_MM_S, CFG_HOME_SLOW_MM_S, CFG_END_MARGIN_MM,
                CFG_OVERRUN_MM, CFG_P_NOM_MM, (unsigned long)CFG_SEED,
                CFG_X_REF_MM < 0 ? "centre" : "fixed",
                (unsigned long)CFG_T_SETTLE_MS, (unsigned long)CFG_T_RECORD_MS,
                cfg.nRuns, cfg.warmupMaxMin, CFG_END_HOLD ? "hold" : "disabled",
                CFG_HASH);
}

void settingsMenu() {
  for (;;) {
    Serial.println();
    printConfig();
    const char k = readKey("  c current  v velocity  n runs  w warm-up max  b back > ");
    switch (k) {
      case 'c': {
        const long v = readLine("  run current mA (50-1200), Enter: ").toInt();
        if (v >= 50 && v <= 1200) applyCurrent((uint16_t)v);
        else Serial.println("  unchanged");
        break;
      }
      case 'v': {
        const double v = readLine("  approach velocity mm/s, Enter: ").toDouble();
        const uint16_t fs = fsOf(v);
        if (v > 0 && fs > 0 && (uint32_t)fs * MRES <= MAX_PULSE_RATE_HZ) cfg.vFs = fs;
        else Serial.printf("  rejected: at most %.2f mm/s at 1/%u\n",
                           MAX_PULSE_RATE_HZ / (double)MRES / FS_PER_MM, MRES);
        break;
      }
      case 'n': {
        const long v = readLine("  ISO runs (1-20), Enter: ").toInt();
        if (v >= 1 && v <= 20) cfg.nRuns = (uint8_t)v;
        else Serial.println("  unchanged");
        break;
      }
      case 'w': {
        const long v = readLine("  warm-up max minutes (1-240), Enter: ").toInt();
        if (v >= 1 && v <= 240) cfg.warmupMaxMin = (uint16_t)v;
        else Serial.println("  unchanged");
        break;
      }
      case 'b': case 27: case '\n': case 'q':
        return;
      default:
        break;
    }
  }
}

void printMenu() {
  Serial.println(F("\n================================================================"));
  Serial.println(F(" ISO 230-2 baseline - positioning accuracy and repeatability"));
  Serial.printf(  " driver=%u homed=%u   1/%u   %u mA   v %.2f mm/s   config %s\n",
                driverReady ? 1u : 0u, homed ? 1u : 0u, MRES, cfg.currentMa,
                cfg.vFs / FS_PER_MM, CFG_HASH);
  if (homed) {
    Serial.printf(" ROM %.4f mm   %u targets %.3f..%.3f mm   x_ref %.3f   x %.4f mm\n",
                  mmOf(romU256), nTargets, mmOf(targetU256[0]),
                  mmOf(targetU256[nTargets - 1]), mmOf(xRefU256), mmOf(xNow()));
  } else {
    Serial.println(F(" not homed - run 1 first"));
  }
  Serial.println(F("================================================================"));
  Serial.println(F("  1  Home + warm-up    home, place the targets, warm up (key = stop after cycle)"));
  Serial.println(F("  2  ISO sequence      datum, n runs, end reference, park"));
  Serial.println(F("  3  Settings          current, velocity, runs, warm-up max"));
  Serial.println(F("  4  Show plan         targets, limits, x_ref"));
  Serial.println(F("  5  Go to x_ref       fixed-side approach"));
  Serial.println(F("  6  Home only         home and place the targets, then wait"));
  Serial.println(F("  7  Driver readback   registers and status"));
  Serial.println(F("  8  Switch state      read both end switches now"));
  Serial.println(F("  0  Release motor     EN high, outputs off"));
  Serial.println(F("  ?  This menu         (keys act at once - Ctrl+C sends ABORT)"));
  Serial.print  (F("\n> "));
}

/** Home with keys stopping it; leaves the outcome in `homed`. */
bool homeInteractive() {
  abortRequested = false;
  stopReason = STOP_NONE;
  setKeys(true, true);
  Serial.println("Homing - any key stops it.");
  const bool ok = home();
  setKeys(false, false);
  state = ST_IDLE;
  if (!ok) {
    Serial.printf("Homing %s (%s) - not homed.\n",
                  stopReason == STOP_KEY ? "stopped" : "failed", STOP_NAME[stopReason]);
    if (stopReason == STOP_ERROR || stopReason == STOP_SWITCH) {
      // A switch closed where it should not have: do not trust the position.
      digitalWrite(EN_PIN, HIGH);
      Serial.println("Motor disabled.");
    }
  }
  return ok;
}

void dispatchMenu(char key) {
  Serial.println(key);
  switch (key) {
    case '1':
      if (homeInteractive()) {
        const WarmupOutcome w = runWarmup();
        if (w == WARMUP_TO_ISO) runIso();
        else if (w == WARMUP_FAILED) abortAndMaybePark();
        state = ST_IDLE;
      }
      break;
    case '2': runIso(); break;
    case '3': settingsMenu(); break;
    case '4': printPlan(); break;
    case '5':
      if (!homed) { Serial.println("Not homed."); break; }
      abortRequested = false;
      setKeys(true, true);
      if (moveX(snapU256(mmOf(xRefU256) - CFG_REF_PREAPPROACH_MM)) && moveX(xRefU256))
        Serial.println("At x_ref.");
      setKeys(false, false);
      break;
    case '6': homeInteractive(); break;
    case '7': reportDriver(); break;
    case '8':
      Serial.printf("# SWITCHES,neg=%u,pos=%u,home=%s\n", switchNeg() ? 1u : 0u,
                    switchPos() ? 1u : 0u, CFG_HOME_MIN ? "neg" : "pos");
      break;
    case '0':
      digitalWrite(EN_PIN, HIGH);
      homed = false;
      Serial.println("Outputs off. Home again before moving.");
      break;
    case '?': break;
    default:
      Serial.println("Unknown key.");
      break;
  }
  printMenu();
}

bool handleHostCommand(const String &line) {
  if (line.equalsIgnoreCase("PING")) {
    Serial.printf("# PONG,fw=iso230_2,ready=%u,homed=%u,config=%s\n",
                  driverReady ? 1u : 0u, homed ? 1u : 0u, CFG_HASH);
    return true;
  }
  if (line.equalsIgnoreCase("DRIVER")) { reportDriver(); return true; }
  if (line.equalsIgnoreCase("STATUS")) {
    Serial.printf("# STATUS,x=%lld,motor=%lld,enc=%ld,homed=%u,state=%s\n",
                  (long long)xNow(), (long long)motorU256, (long)encoderCount(),
                  homed ? 1u : 0u, STATE_NAME[state]);
    return true;
  }
  if (line.equalsIgnoreCase("PLAN")) { printPlan(); return true; }
  return false;
}

// ------------------------------------------------------------------- setup

void setup() {
  pinMode(EN_PIN, OUTPUT);
  digitalWrite(EN_PIN, HIGH);
  pinMode(STEP_PIN, OUTPUT);
  pinMode(DIR_PIN, OUTPUT);
  pinMode(LED_PIN, OUTPUT);
  digitalWrite(STEP_PIN, LOW);
  digitalWrite(DIR_PIN, HIGH);
  digitalWrite(LED_PIN, LOW);
  pinMode(SW_NEG_PIN, INPUT_PULLUP);
  pinMode(SW_POS_PIN, INPUT_PULLUP);

  Serial.begin(115200);
  const uint32_t start = millis();
  while (!Serial && millis() - start < 3000) delay(10);
  delay(200);

  cfg.vFs = fsOf(CFG_V_MM_S);
  accelPulsesS2 = (uint32_t)lround(CFG_A_MM_S2 * FS_PER_MM * MRES);

  state = ST_INIT;
  Serial.printf("# BOOT,fw=iso230_2,config=%s\n", CFG_HASH);
  Serial.printf("# PINS,step=%u,dir=%u,en=%u,sw_neg=%u,sw_pos=%u,home=%s\n",
                STEP_PIN, DIR_PIN, EN_PIN, SW_NEG_PIN, SW_POS_PIN,
                CFG_HOME_MIN ? "neg" : "pos");
  encoderReady = setupEncoder();
  // INIT: rates first - a velocity the step generator cannot make is a config
  // error, and the motor is never enabled with one.
  bool ratesOk = true;
  const double rates[] = {CFG_V_MM_S, CFG_HOME_SEEK_MM_S, CFG_HOME_SLOW_MM_S};
  for (double v : rates) {
    if (fsOf(v) == 0 || (uint32_t)fsOf(v) * MRES > MAX_PULSE_RATE_HZ) {
      Serial.printf("# ERR,reason=velocity_out_of_range,mm_s=%.3f,mres=%u\n", v, MRES);
      ratesOk = false;
    }
  }
  driverReady = ratesOk && configureDriver();
  if (!driverReady) Serial.println("# ERR,reason=init_failed,motor_disabled");
  else digitalWrite(EN_PIN, LOW);
  state = ST_IDLE;
  Serial.printf("# READY,driver=%u,encoder=%u\n", driverReady ? 1u : 0u,
                encoderReady ? 1u : 0u);
  printConfig();
  nextSampleMs = millis();
  printMenu();
}

void loop() {
  pumpSerial();
  if (abortRequested && !running) {
    abortRequested = false;
    Serial.println("# ABORT");
  }
  if (pendingLine.length()) {
    const String line = pendingLine;
    pendingLine = "";
    if (handleHostCommand(line)) return;
    if (line.length() == 1) {
      if (!driverReady && line[0] != '7' && line[0] != '8' && line[0] != '?') {
        Serial.println("INIT failed - motion is disabled. See the # ERR lines above.");
        printMenu();
        return;
      }
      dispatchMenu(line[0]);
      return;
    }
    Serial.println("# ERR,reason=unknown_command");
    Serial.print("> ");
  }
  delay(2);
}
