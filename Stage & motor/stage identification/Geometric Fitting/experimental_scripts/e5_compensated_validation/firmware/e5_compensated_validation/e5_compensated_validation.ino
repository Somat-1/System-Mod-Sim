/*
 * E5 compensated validation v2 - ESP32-S3 + TMC2209.
 *
 * The host-generated e5_config.h contains every integer command in execution
 * order.  No geometric model is evaluated here.  STEP is generated by the
 * proven buffered RMT trapezoidal path used by E1-E4.  During the experiment
 * all stop timing is retained in RAM; UART output resumes only after SEQ_DONE.
 *
 * Before flashing, perform the E0 warm-up with step_timing_test.  Then flash
 * this sketch and use 'g' to re-home, centre and run, or 'p'/'r' when already
 * homed and physically parked at 61.35 mm.
 */

#include <Arduino.h>
#include <TMCStepper.h>
#include "driver/rmt_tx.h"
#include "e5_config.h"

constexpr uint8_t STEP_PIN = 7;
constexpr uint8_t DIR_PIN = 8;
constexpr uint8_t EN_PIN = 9;
constexpr uint8_t UART_RX_PIN = 18;
constexpr uint8_t UART_TX_PIN = 17;
constexpr uint8_t SW_NEG_PIN = 10;
constexpr uint8_t SW_POS_PIN = 11;
constexpr int SWITCH_ACTIVE_LEVEL = LOW;
constexpr uint8_t DRIVER_ADDRESS = 0;
constexpr float R_SENSE_OHM = 0.10F;
constexpr uint32_t DRIVER_BAUD = 115200;
constexpr uint16_t STEP_HIGH_US = 3;
constexpr uint32_t MAX_RMT_PERIOD_US = 30000;
constexpr double USTEP_PER_MM =
    (double)CFG_STEPS_PER_REV * (double)CFG_MRES / CFG_LEAD_MM;

HardwareSerial TmcSerial(1);
TMC2209Stepper driver(&TmcSerial, R_SENSE_OHM, DRIVER_ADDRESS);
rmt_channel_handle_t rmtChannel = nullptr;
rmt_encoder_handle_t rmtEncoder = nullptr;
rmt_symbol_word_t rmtBuffers[CFG_RMT_RING][CFG_RMT_CHUNK];
size_t rmtBufferIndex = 0;

struct TimingRecord {
  uint16_t actionIndex;
  uint32_t moveStartMs;
  uint32_t moveEndMs;
  uint32_t recordStartMs;
  uint32_t recordEndMs;
  uint16_t mscnt;
  uint32_t drvStatus;
};

TimingRecord timingRecords[CFG_STOP_COUNT];
uint16_t timingCount = 0;
int32_t positionU = CFG_PARK_U;
uint8_t currentState = 0;
bool driverReady = false;
bool rmtReady = false;
bool positionArmed = false;
bool abortRequested = false;
bool unsafeFault = false;
bool running = false;
bool timeLimited = false;
bool lastDirPositive = true;
bool directionKnown = false;
uint32_t sequenceStartedMs = 0;
uint16_t homeNegMscnt = 0;
uint16_t homePosMscnt = 0;
uint16_t centreMscnt = 0;
bool homePhaseValid = false;

inline double mmOf(int32_t u) { return (double)u / USTEP_PER_MM; }
inline int32_t ustepsOf(double mm) { return (int32_t)llround(mm * USTEP_PER_MM); }

const char *modeName(uint8_t mode) {
  if (mode == 1) return "U";
  if (mode == 2) return "C";
  return "NONE";
}

bool switchPressed(uint8_t pin) {
  if (digitalRead(pin) != SWITCH_ACTIVE_LEVEL) return false;
  delayMicroseconds(300);
  return digitalRead(pin) == SWITCH_ACTIVE_LEVEL;
}

bool switchAhead(bool positive) {
  return switchPressed(positive ? SW_POS_PIN : SW_NEG_PIN);
}

void syncWrite(bool high) {
  if (CFG_SYNC_GPIO >= 0) digitalWrite((uint8_t)CFG_SYNC_GPIO, high ? HIGH : LOW);
}

bool pollAbort() {
  while (Serial.available()) {
    if ((char)Serial.read() == 3) abortRequested = true;
  }
  return abortRequested;
}

bool waitMs(uint32_t durationMs) {
  const uint32_t until = millis() + durationMs;
  while ((int32_t)(millis() - until) < 0) {
    if (pollAbort()) return false;
    delay(2);
  }
  return true;
}

bool beginRmt() {
  rmt_tx_channel_config_t channel = {};
  channel.gpio_num = (gpio_num_t)STEP_PIN;
  channel.clk_src = RMT_CLK_SRC_DEFAULT;
  channel.resolution_hz = CFG_RMT_HZ;
  channel.mem_block_symbols = 64;
  channel.trans_queue_depth = CFG_RMT_QUEUE_DEPTH;
  channel.flags.invert_out = false;
  channel.flags.with_dma = false;
  if (rmt_new_tx_channel(&channel, &rmtChannel) != ESP_OK) return false;
  rmt_copy_encoder_config_t encoder = {};
  if (rmt_new_copy_encoder(&encoder, &rmtEncoder) != ESP_OK) return false;
  return rmt_enable(rmtChannel) == ESP_OK;
}

inline void makeRmtSymbol(rmt_symbol_word_t &symbol, uint32_t periodUs) {
  if (periodUs <= STEP_HIGH_US) periodUs = STEP_HIGH_US + 1;
  if (periodUs > MAX_RMT_PERIOD_US) periodUs = MAX_RMT_PERIOD_US;
  symbol.level0 = 1;
  symbol.duration0 = STEP_HIGH_US;
  symbol.level1 = 0;
  symbol.duration1 = periodUs - STEP_HIGH_US;
}

void setDirection(bool positive) {
  if (directionKnown && positive == lastDirPositive) return;
  digitalWrite(DIR_PIN, positive ? HIGH : LOW);
  delayMicroseconds(20);
  lastDirPositive = positive;
  directionKnown = true;
}

uint32_t emitPulses(uint32_t pulses, bool positive,
                    double vMmS = CFG_V_MM_S,
                    uint32_t chunk = CFG_RMT_CHUNK,
                    bool seeking = false) {
  if (!pulses) return 0;
  setDirection(positive);
  const double vMax = vMmS * USTEP_PER_MM;
  const double accel = CFG_A_MM_S2 * USTEP_PER_MM;
  uint32_t nAccel = (uint32_t)(vMax * vMax / (2.0 * accel));
  if (2 * nAccel > pulses) nAccel = pulses / 2;
  uint32_t queued = 0;
  while (queued < pulses) {
    if (pollAbort()) break;
    if (switchAhead(positive)) {
      if (!seeking) unsafeFault = true;
      break;
    }
    const uint32_t count = min(chunk, pulses - queued);
    const int32_t next = positionU + (positive ? (int32_t)count : -(int32_t)count);
    if (!seeking && ((positive && next > CFG_SOFT_MAX_U) ||
                     (!positive && next < CFG_SOFT_MIN_U))) {
      unsafeFault = true;
      break;
    }
    rmt_symbol_word_t *buffer = rmtBuffers[rmtBufferIndex];
    rmtBufferIndex = (rmtBufferIndex + 1) % CFG_RMT_RING;
    for (uint32_t k = 0; k < count; ++k) {
      const uint32_t i = queued + k;
      double rate;
      if (i < nAccel) rate = sqrt(2.0 * accel * (double)(i + 1));
      else if (i >= pulses - nAccel)
        rate = sqrt(2.0 * accel * (double)(pulses - i));
      else rate = vMax;
      if (rate < 1.0) rate = 1.0;
      makeRmtSymbol(buffer[k], (uint32_t)llround(1000000.0 / rate));
    }
    rmt_transmit_config_t tx = {};
    tx.loop_count = 0;
    if (rmt_transmit(rmtChannel, rmtEncoder, buffer,
                     count * sizeof(rmt_symbol_word_t), &tx) != ESP_OK) {
      unsafeFault = true;
      break;
    }
    queued += count;
    positionU += positive ? (int32_t)count : -(int32_t)count;
  }
  if (rmt_tx_wait_all_done(rmtChannel, -1) != ESP_OK) unsafeFault = true;
  return queued;
}

bool moveTo(int32_t targetU, uint32_t *tStart = nullptr,
            uint32_t *tEnd = nullptr, bool verbose = false) {
  if (!positionArmed || targetU < CFG_SOFT_MIN_U || targetU > CFG_SOFT_MAX_U) {
    unsafeFault = true;
    return false;
  }
  const int32_t delta = targetU - positionU;
  const bool positive = delta >= 0;
  const uint32_t wanted = (uint32_t)(positive ? delta : -delta);
  const uint32_t started = millis();
  if (tStart) *tStart = started;
  if (verbose)
    Serial.printf("# EVENT,%lu,move_start,target_usteps=%ld\n",
                  (unsigned long)started, (long)targetU);
  const uint32_t emitted = emitPulses(wanted, positive);
  const uint32_t ended = millis();
  if (tEnd) *tEnd = ended;
  if (verbose)
    Serial.printf("# EVENT,%lu,arrive,target_usteps=%ld,emitted=%lu\n",
                  (unsigned long)ended, (long)targetU, (unsigned long)emitted);
  return emitted == wanted && !unsafeFault && !abortRequested;
}

// Homing is identical to the proven E0/E1-E4 implementation.
constexpr double HOME_SEEK_MM_S = 2.0;
constexpr double HOME_SLOW_MM_S = 0.15;
constexpr double HOME_BACKOFF_MM = 2.0;
constexpr uint8_t HOME_TOUCHES = 3;
constexpr double HOME_TOL_MM = 0.02;
constexpr double HOME_MAX_TRAVEL_MM = 200.0;
constexpr double END_MARGIN_MM = 2.0;
constexpr uint32_t HOME_CHUNK = 16;

void jog(double mm, double vMmS) {
  const int32_t delta = ustepsOf(mm);
  emitPulses((uint32_t)(delta >= 0 ? delta : -delta), delta >= 0,
             vMmS, HOME_CHUNK, true);
}

bool homeEnd(bool positive, int32_t *trigger) {
  const double sign = positive ? 1.0 : -1.0;
  if (switchAhead(positive)) jog(-sign * HOME_BACKOFF_MM, HOME_SLOW_MM_S);
  jog(sign * HOME_MAX_TRAVEL_MM, HOME_SEEK_MM_S);
  if (abortRequested || !switchAhead(positive)) return false;
  int32_t lo = 0, hi = 0;
  for (uint8_t touch = 0; touch < HOME_TOUCHES; ++touch) {
    jog(-sign * HOME_BACKOFF_MM, HOME_SLOW_MM_S);
    jog(sign * 3.0 * HOME_BACKOFF_MM, HOME_SLOW_MM_S);
    if (abortRequested || !switchAhead(positive)) return false;
    if (touch == 0 || positionU < lo) lo = positionU;
    if (touch == 0 || positionU > hi) hi = positionU;
  }
  Serial.printf("# HOME_END,%s,spread_mm=%.4f\n",
                positive ? "pos" : "neg", mmOf(hi - lo));
  if (mmOf(hi - lo) > HOME_TOL_MM) return false;
  *trigger = positive ? lo : hi;
  return true;
}

bool homeAndCentre() {
  positionArmed = false;
  abortRequested = unsafeFault = false;
  digitalWrite(EN_PIN, LOW);
  int32_t negTrigger = 0, posTrigger = 0;
  if (!homeEnd(false, &negTrigger)) {
    Serial.println("# ERR,reason=home_neg");
    return false;
  }
  homeNegMscnt = (uint16_t)driver.MSCNT();
  jog(HOME_BACKOFF_MM, HOME_SLOW_MM_S);
  if (!homeEnd(true, &posTrigger)) {
    Serial.println("# ERR,reason=home_pos");
    return false;
  }
  homePosMscnt = (uint16_t)driver.MSCNT();
  positionU -= negTrigger;
  const int32_t travel = posTrigger - negTrigger;
  Serial.printf("# HOMED,travel_mm=%.4f,soft_mm=%.3f..%.3f\n",
                mmOf(travel), mmOf(CFG_SOFT_MIN_U), mmOf(CFG_SOFT_MAX_U));
  if (CFG_SOFT_MIN_U < ustepsOf(END_MARGIN_MM) ||
      CFG_SOFT_MAX_U > travel - ustepsOf(END_MARGIN_MM)) {
    Serial.println("# ERR,reason=travel_short_for_soft_limits");
    return false;
  }
  positionArmed = true;
  const int32_t pre = CFG_PARK_U - ustepsOf(3.0);
  if (!moveTo(pre, nullptr, nullptr, true) ||
      !moveTo(CFG_PARK_U, nullptr, nullptr, true)) return false;
  centreMscnt = (uint16_t)driver.MSCNT();
  homePhaseValid = true;
  Serial.printf("# CENTRED,x_usteps=%ld,x_mm=%.6f,MSCNT=%u,"
                "home_neg_MSCNT=%u,home_pos_MSCNT=%u\n",
                (long)positionU, mmOf(positionU), centreMscnt,
                homeNegMscnt, homePosMscnt);
  return true;
}

bool configureDriver() {
  digitalWrite(EN_PIN, HIGH);
  TmcSerial.begin(DRIVER_BAUD, SERIAL_8N1, UART_RX_PIN, UART_TX_PIN);
  delay(100);
  driver.begin();
  driver.toff(5);
  driver.blank_time(24);
  driver.pdn_disable(true);
  driver.mstep_reg_select(true);
  driver.I_scale_analog(false);
  driver.rms_current(CFG_RUN_CURRENT_MA);
  driver.ihold(driver.irun());
  driver.iholddelay(CFG_IHOLDDELAY);
  driver.TPOWERDOWN(CFG_TPOWERDOWN);
  driver.en_spreadCycle(true);
  driver.TPWMTHRS(0);
  driver.intpol(false);
  driver.semin(0);
  driver.TCOOLTHRS(0);
  driver.pwm_autoscale(false);
  uint8_t code = 8;
  for (uint16_t value = CFG_MRES; value > 1; value >>= 1) --code;
  const uint32_t mask = 0x0F000000UL;
  driver.CHOPCONF((driver.CHOPCONF() & ~mask) | ((uint32_t)code << 24));
  uint8_t connection = 2;
  for (uint8_t attempt = 0; attempt < 5 && connection; ++attempt) {
    connection = driver.test_connection();
    if (connection) delay(50);
  }
  if (connection) return false;
  const uint32_t gconf = driver.GCONF();
  const uint32_t chop = driver.CHOPCONF();
  const uint32_t status = driver.DRV_STATUS();
  const bool readback = (gconf & (1UL << 2)) && !(status & (1UL << 30)) &&
                        !(chop & (1UL << 28)) &&
                        (((chop & mask) >> 24) == code) &&
                        driver.ihold() == driver.irun();
  Serial.printf("# DRIVER,gconf=0x%08lX,chopconf=0x%08lX,status=0x%08lX,"
                "mres=%u,irun=%u,ihold=%u,tpowerdown=%u,iholddelay=%u\n",
                (unsigned long)gconf, (unsigned long)chop,
                (unsigned long)status, CFG_MRES, driver.irun(), driver.ihold(),
                CFG_TPOWERDOWN, CFG_IHOLDDELAY);
  if (!readback) return false;
  digitalWrite(EN_PIN, LOW);
  return true;
}

bool driverStatusFault(uint32_t status) {
  return status & ((1UL << 1) | (1UL << 2) | (1UL << 3) |
                   (1UL << 4) | (1UL << 5));
}

bool executeStop(uint16_t actionIndex, const E5Action &action) {
  if (timingCount >= CFG_STOP_COUNT) {
    unsafeFault = true;
    return false;
  }
  TimingRecord &record = timingRecords[timingCount];
  record.actionIndex = actionIndex;
  if (!moveTo(action.u_cmd, &record.moveStartMs, &record.moveEndMs, false))
    return false;
  if (!waitMs(CFG_SETTLE_MS)) return false;
  record.recordStartMs = millis();
  syncWrite(true);
  const bool held = waitMs(CFG_RECORD_MS);
  syncWrite(false);
  record.recordEndMs = millis();
  if (!held) return false;
  record.mscnt = (uint16_t)driver.MSCNT();
  record.drvStatus = driver.DRV_STATUS();
  ++timingCount;
  if (driverStatusFault(record.drvStatus)) {
    unsafeFault = true;
    return false;
  }
  return true;
}

void printHeader() {
  Serial.printf("# SESSION,experiment=E5_compensated_validation,procedure=v2,"
                "config_sha256=%s,model_sha256=%s,table_sha256=%s,b3_seed=%lu,"
                "actions=%u,stops=%u,motion=RMT\n",
                CFG_HASH, CFG_MODEL_HASH, CFG_TABLE_HASH,
                (unsigned long)CFG_B3_SEED, CFG_ACTION_COUNT, CFG_STOP_COUNT);
  Serial.printf("# SETTINGS,lead_mm=%.3f,steps_rev=%u,mres=%u,chopper=SpreadCycle,"
                "run_ma=%u,hold_ma=%u,v_mm_s=%.3f,a_mm_s2=%.3f,"
                "settle_ms=%lu,record_ms=%lu,aquadb_clock_ns=%u\n",
                CFG_LEAD_MM, CFG_STEPS_PER_REV, CFG_MRES, CFG_RUN_CURRENT_MA,
                CFG_HOLD_CURRENT_MA, CFG_V_MM_S, CFG_A_MM_S2,
                (unsigned long)CFG_SETTLE_MS, (unsigned long)CFG_RECORD_MS,
                CFG_AQUADB_CLOCK_NS);
  Serial.printf("# HOME_PHASE,valid=%u,home_neg_MSCNT=%u,home_pos_MSCNT=%u,"
                "centre_MSCNT=%u,x_usteps=%ld,x_mm=%.6f\n",
                homePhaseValid, homeNegMscnt, homePosMscnt, centreMscnt,
                (long)positionU, mmOf(positionU));
}

void dumpTiming() {
  Serial.println("# TIMING_COLUMNS,row,block,run,mode,dir,target_id,u_nom,u_cmd,"
                 "el_off,MSCNT,move_start_ms,move_end_ms,record_start_ms,"
                 "record_end_ms,drv_status");
  for (uint16_t i = 0; i < timingCount; ++i) {
    const TimingRecord &record = timingRecords[i];
    const E5Action &action = CFG_ACTIONS[record.actionIndex];
    const int16_t elOff = (int16_t)((action.u_cmd + 32) % 64) - 32;
    Serial.printf("# STOP,%u,%s,%u,%s,%d,%u,%ld,%ld,%d,%u,%lu,%lu,%lu,%lu,0x%08lX\n",
                  action.row, CFG_BLOCK_NAMES[action.block], action.run,
                  modeName(action.mode), action.direction, action.target,
                  (long)action.u_nom, (long)action.u_cmd, elOff, record.mscnt,
                  (unsigned long)record.moveStartMs,
                  (unsigned long)record.moveEndMs,
                  (unsigned long)record.recordStartMs,
                  (unsigned long)record.recordEndMs,
                  (unsigned long)record.drvStatus);
  }
}

void runE5() {
  if (!driverReady || !rmtReady || !positionArmed || running) {
    Serial.printf("# ERR,reason=not_ready,driver=%u,rmt=%u,armed=%u,running=%u\n",
                  driverReady, rmtReady, positionArmed, running);
    return;
  }
  running = true;
  abortRequested = unsafeFault = timeLimited = false;
  timingCount = 0;
  sequenceStartedMs = millis();
  centreMscnt = (uint16_t)driver.MSCNT();
  printHeader();
  Serial.println("# SEQ_START,uart_quiet=1,timing_buffer=RAM");
  bool ok = true;
  for (uint16_t i = 0; ok && i < CFG_ACTION_COUNT; ++i) {
    if (millis() - sequenceStartedMs >= CFG_WATCHDOG_MS) {
      timeLimited = true;
      ok = false;
      break;
    }
    const E5Action &action = CFG_ACTIONS[i];
    currentState = action.state;
    if (action.type == E5_MOVE)
      ok = moveTo(action.u_cmd, nullptr, nullptr, false);
    else if (action.type == E5_STOP)
      ok = executeStop(i, action);
    if (abortRequested || unsafeFault) ok = false;
  }
  const uint32_t elapsed = millis() - sequenceStartedMs;
  const bool complete = ok && timingCount == CFG_STOP_COUNT;
  Serial.printf("# SEQ_DONE,elapsed_ms=%lu,stops=%u,complete=%u,aborted=%u,"
                "unsafe=%u,time_limited=%u,state=%s\n",
                (unsigned long)elapsed, timingCount, complete, abortRequested,
                unsafeFault, timeLimited, CFG_STATE_NAMES[currentState]);
  dumpTiming();
  Serial.printf("# SUMMARY,model_sha256=%s,table_sha256=%s,home_neg_MSCNT=%u,"
                "final_x_usteps=%ld,records_dumped=%u\n",
                CFG_MODEL_HASH, CFG_TABLE_HASH, homeNegMscnt,
                (long)positionU, timingCount);
  if (!complete || unsafeFault) {
    digitalWrite(EN_PIN, HIGH);
    positionArmed = false;
  }
  running = false;
}

void printMenu() {
  Serial.println("\n--- E5 compensated validation v2 ---");
  Serial.printf("driver=%u rmt=%u armed_at_park=%u position_mm=%.6f\n",
                driverReady, rmtReady, positionArmed, mmOf(positionU));
  Serial.println("g  re-home, centre, run     h  re-home and centre only");
  Serial.println("p  arm manually at 61.35 mm  r  run generated table");
  Serial.println("t  table/hash summary        s  status");
  Serial.println("0  release motor             Ctrl+C aborts");
  Serial.print("> ");
}

void setup() {
  pinMode(EN_PIN, OUTPUT);
  digitalWrite(EN_PIN, HIGH);
  pinMode(DIR_PIN, OUTPUT);
  digitalWrite(DIR_PIN, HIGH);
  pinMode(SW_NEG_PIN, INPUT_PULLUP);
  pinMode(SW_POS_PIN, INPUT_PULLUP);
  if (CFG_SYNC_GPIO >= 0) {
    pinMode((uint8_t)CFG_SYNC_GPIO, OUTPUT);
    syncWrite(false);
  }
  Serial.begin(115200);
  const uint32_t started = millis();
  while (!Serial && millis() - started < 3000) delay(10);
  delay(200);
  Serial.printf("# BOOT,fw=e5_compensated_validation_v2,config_sha256=%s\n", CFG_HASH);
  rmtReady = beginRmt();
  driverReady = configureDriver();
  Serial.printf("# READY,driver=%u,rmt=%u,precondition_armed=0\n",
                driverReady, rmtReady);
  Serial.println("# PRECONDITION_REQUIRED,E0_warmup_complete=1,IDS_recording=1");
  printMenu();
}

void loop() {
  if (!Serial.available()) {
    delay(5);
    return;
  }
  const char key = (char)Serial.read();
  if (key == '\r' || key == '\n') return;
  if (key == 3) {
    abortRequested = true;
    Serial.println("# ABORT_REQUEST");
    return;
  }
  switch (key) {
    case 'p':
      if (!driverReady || !rmtReady || switchPressed(SW_NEG_PIN) ||
          switchPressed(SW_POS_PIN)) {
        Serial.println("# ERR,reason=cannot_arm");
      } else {
        digitalWrite(EN_PIN, LOW);
        positionU = CFG_PARK_U;
        positionArmed = true;
        abortRequested = unsafeFault = false;
        centreMscnt = (uint16_t)driver.MSCNT();
        homePhaseValid = false;
        Serial.printf("# PRECONDITION_ARMED,x_usteps=%ld,x_mm=%.6f,MSCNT=%u,"
                      "home_phase_valid=0\n",
                      (long)positionU, mmOf(positionU), centreMscnt);
      }
      break;
    case 'r': runE5(); break;
    case 'h': homeAndCentre(); break;
    case 'g': if (homeAndCentre()) runE5(); break;
    case 's':
      Serial.printf("# STATUS,state=%s,armed=%u,x_usteps=%ld,x_mm=%.6f,"
                    "neg=%u,pos=%u,MSCNT=%u,status=0x%08lX\n",
                    CFG_STATE_NAMES[currentState], positionArmed,
                    (long)positionU, mmOf(positionU), switchPressed(SW_NEG_PIN),
                    switchPressed(SW_POS_PIN), (uint16_t)driver.MSCNT(),
                    (unsigned long)driver.DRV_STATUS());
      break;
    case 't':
      Serial.printf("# PLAN,actions=%u,stops=%u,b3_seed=%lu,model_sha256=%s,"
                    "table_sha256=%s,watchdog_ms=%lu\n",
                    CFG_ACTION_COUNT, CFG_STOP_COUNT, (unsigned long)CFG_B3_SEED,
                    CFG_MODEL_HASH, CFG_TABLE_HASH,
                    (unsigned long)CFG_WATCHDOG_MS);
      break;
    case '0':
      digitalWrite(EN_PIN, HIGH);
      positionArmed = false;
      Serial.println("# MOTOR_RELEASED,coordinate_invalid=1");
      break;
    case '?': break;
    default: Serial.println("# ERR,reason=unknown_command"); break;
  }
  printMenu();
}
